## TEST_MODEM_UBLOX/Kconfig.defconfig
```kconfig
# Adafruit Feather M0 Basic Proto board configuration

# Copyright (c) 2018 Henrik Brix Andersen <henrik@brixandersen.dk>
# SPDX-License-Identifier: Apache-2.0

if BOARD_ADAFRUIT_FEATHER_M0_BASIC_PROTO

config BOARD
	default "adafruit_feather_m0_basic_proto"

if MODEM

config MODEM_UBLOX_SARA
	default y

choice MODEM_UBLOX_SARA_VARIANT
	default MODEM_UBLOX_SARA_R4
endchoice

config UART_INTERRUPT_DRIVEN
	default y

endif # MODEM

endif # BOARD_ADAFRUIT_FEATHER_M0_BASIC_PROTO
```

## arduino_mkrnb1500/Kconfig.board
```kconfig
# Arduino MKR Zero Board configuration

# Copyright (c) 2022 TOKITA Hiroshi <tokita.hiroshi@fujitsu.com>
# SPDX-License-Identifier: Apache-2.0

config BOARD_ARDUINO_MKRNB1500
	bool "Arduino MKR NB 1500"
	depends on SOC_PART_NUMBER_SAMD21G18A
```
