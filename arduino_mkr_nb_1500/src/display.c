#include "functions.h"
#include <zephyr/display/ssd16xx.h>

#include <zephyr/logging/log.h>
LOG_MODULE_REGISTER(sample, LOG_LEVEL_INF);


#ifdef CONFIG_ARCH_POSIX
#include "posix_board_if.h"
#endif

#ifdef CONFIG_ARCH_POSIX
#define RETURN_FROM_MAIN(exit_code) posix_exit_main(exit_code)
#else
#define RETURN_FROM_MAIN(exit_code) return
#endif





#ifdef CONFIG_ARCH_POSIX
static void posix_exit_main(int exit_code)
{
#if CONFIG_TEST
	if (exit_code == 0) {
		LOG_INF("PROJECT EXECUTION SUCCESSFUL");
	} else {
		LOG_INF("PROJECT EXECUTION FAILED");
	}
#endif
	posix_exit(exit_code);
}
#endif


uint8_t stateDisplay = 0;


// 'paprec_logotype_72', 72x72px
static const uint8_t  image_data2[] = {
0xff, 0xff, 0xff, 0xff, 0xff, 0xff, 0xff, 0xff, 0xff, 0xff, 0xff, 0xff, 0xff, 0xff, 0xff, 0xff, 
0xfe, 0xfc, 0xfc, 0xf8, 0xf8, 0xf1, 0xf3, 0xe3, 0xe3, 0xe7, 0xc7, 0xcf, 0xcf, 0xcf, 0x8f, 0x8f, 
0x9f, 0x9f, 0x9f, 0x9f, 0x9f, 0x9f, 0x9f, 0x9f, 0x8f, 0x8f, 0xcf, 0xcf, 0xcf, 0xc7, 0xc7, 0xe7, 
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0xff, 0xff, 0xff, 0xff, 0xff, 0xff, 0xff, 0xff
};
 
 
 
// 'paprec_logotype_48', 48x48px
static const uint8_t  image_data[] = {
0xff, 0xff, 0xff, 0xff, 0xff, 0xff, 0xff, 0xff, 0xfc, 0xfc, 0xf8, 0xe0, 0xe0, 0xe0, 0xc8, 0xdc, 
0x9c, 0x9c, 0x9e, 0xbf, 0xbf, 0xbf, 0xbf, 0xbf, 0xbf, 0xbf, 0xbf, 0x9f, 0x9f, 0x9f, 0x9f, 0x9f, 
0xcf, 0xcf, 0xc7, 0xe3, 0xf3, 0xf9, 0xfc, 0xfc, 0xff, 0xff, 0xff, 0xff, 0xff, 0xff, 0xff, 0xff, 
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0xf7, 0xe7, 0xc7, 0xcf, 0xcf, 0x9f, 0x3f, 0x3f, 0xff, 0xff, 0xff, 0xff, 0xff, 0xff, 0xff, 0xff
};
 

uint8_t vide = 0;

void display_logo(const struct device *display_dev, struct display_capabilities capabilities){
		
	size_t x;
	size_t y;
	size_t rect_w;
	size_t rect_h;
	size_t h_step;
	size_t scale;

	uint8_t *buf;


	struct display_buffer_descriptor buf_desc;
	size_t buf_size = 0;

	if (capabilities.screen_info & SCREEN_INFO_MONO_VTILED) {
		rect_w = 16;
		rect_h = 8;
	} else {
		rect_w = 2;
		rect_h = 1;
	}


	/*printk("rect_w %d\n", rect_w);
	printk("rect_h %d\n", rect_h);*/

	h_step = rect_h;
	scale = (capabilities.x_resolution / 8) / rect_h;

	rect_w *= scale;
	rect_h *= scale;
	
	/*printk("rect_w %d\n", rect_w);
	printk("rect_h %d\n", rect_h);*/


	buf_size = rect_w * rect_h;

	if (buf_size < (capabilities.x_resolution * h_step)) {
		buf_size = capabilities.x_resolution * h_step;
	}


	//printk("buf_size %d\n", buf_size);
	buf_size /= 8;
	//printk("buf_size %d\n", buf_size);

	buf = k_malloc(buf_size);

	if (buf == NULL) {
		//LOG_ERR("Could not allocate memory. Aborting sample.");
		RETURN_FROM_MAIN(1);
	}

	(void)memset(buf, 0xFF, buf_size);



	
			
	buf_desc.buf_size = buf_size;
	buf_desc.pitch = capabilities.x_resolution;
	buf_desc.width = capabilities.x_resolution;
	buf_desc.height = h_step;
	
	/*printk("buf_desc.buf_size %d\n", buf_desc.buf_size);
	printk("buf_desc.pitch %d\n", buf_desc.pitch);
	printk("buf_desc.width %d\n", buf_desc.width);
	printk("buf_desc.height %d\n", buf_desc.height);*/
	



	buf_desc.pitch = rect_w;
	buf_desc.width = rect_w;
	buf_desc.height = rect_h;
	
	
	/*printk("buf_desc.buf_size %d\n", buf_desc.buf_size);
	printk("buf_desc.pitch %d\n", buf_desc.pitch);
	printk("buf_desc.width %d\n", buf_desc.width);
	printk("buf_desc.height %d\n", buf_desc.height);*/
	

	memset(buf, 0, buf_size);
	
	
	buf_desc.buf_size = 648;
	buf_desc.pitch = 72;
	buf_desc.width = 72;
	buf_desc.height = 72;


	//TOP_LEFT
	//printk("buf_size %d\n", buf_size);
	//x = capabilities.x_resolution - rect_w;
	x = 176;
	y = 8;
	display_write(display_dev, x, y, &buf_desc, image_data2);
}

void display_logo2(const struct device *display_dev, struct display_capabilities capabilities){
		
	size_t x;
	size_t y;
	size_t rect_w;
	size_t rect_h;
	size_t h_step;
	size_t scale;

	uint8_t *buf;


	struct display_buffer_descriptor buf_desc;
	size_t buf_size = 0;

	if (capabilities.screen_info & SCREEN_INFO_MONO_VTILED) {
		rect_w = 16;
		rect_h = 8;
	} else {
		rect_w = 2;
		rect_h = 1;
	}


	/*printk("rect_w %d\n", rect_w);
	printk("rect_h %d\n", rect_h);*/

	h_step = rect_h;
	scale = (capabilities.x_resolution / 8) / rect_h;

	rect_w *= scale;
	rect_h *= scale;
	
	/*printk("rect_w %d\n", rect_w);
	printk("rect_h %d\n", rect_h);*/


	buf_size = rect_w * rect_h;

	if (buf_size < (capabilities.x_resolution * h_step)) {
		buf_size = capabilities.x_resolution * h_step;
	}


	//printk("buf_size %d\n", buf_size);
	buf_size /= 8;
	//printk("buf_size %d\n", buf_size);

	buf = k_malloc(buf_size);

	if (buf == NULL) {
		//LOG_ERR("Could not allocate memory. Aborting sample.");
		RETURN_FROM_MAIN(1);
	}

	(void)memset(buf, 0xFF, buf_size);



	
			
	buf_desc.buf_size = buf_size;
	buf_desc.pitch = capabilities.x_resolution;
	buf_desc.width = capabilities.x_resolution;
	buf_desc.height = h_step;
	
	/*printk("buf_desc.buf_size %d\n", buf_desc.buf_size);
	printk("buf_desc.pitch %d\n", buf_desc.pitch);
	printk("buf_desc.width %d\n", buf_desc.width);
	printk("buf_desc.height %d\n", buf_desc.height);*/
	



	buf_desc.pitch = rect_w;
	buf_desc.width = rect_w;
	buf_desc.height = rect_h;
	
	
	/*printk("buf_desc.buf_size %d\n", buf_desc.buf_size);
	printk("buf_desc.pitch %d\n", buf_desc.pitch);
	printk("buf_desc.width %d\n", buf_desc.width);
	printk("buf_desc.height %d\n", buf_desc.height);*/
	

	memset(buf, 0, buf_size);
	
	
	/*buf_desc.buf_size = 648;
	buf_desc.pitch = 72;
	buf_desc.width = 72;
	buf_desc.height = 72;*/
	
	buf_desc.buf_size = 288;
	buf_desc.pitch = 48;
	buf_desc.width = 48;
	buf_desc.height = 48;


	//TOP_LEFT
	//printk("buf_size %d\n", buf_size);
	//x = capabilities.x_resolution - rect_w;
	x = 184;
	y = 40;
	display_write(display_dev, x, y, &buf_desc, image_data);
}




void init_eink_display(const struct device *display_dev, struct display_capabilities capabilities){

	if (!device_is_ready(display_dev)) {
		LOG_ERR("Device %s not found. Aborting sample.",
			display_dev->name);
		RETURN_FROM_MAIN(1);
	}

	LOG_INF("Display sample for %s", display_dev->name);
	display_get_capabilities(display_dev, &capabilities);
	
	if (cfb_framebuffer_init(display_dev)) {
		printk("Framebuffer initialization failed!\n");
		return;
	}
	
	cfb_framebuffer_clear(display_dev, true);
	display_blanking_off(display_dev);

}


void display_text(const struct device *display_dev, struct display_capabilities capabilities, uint8_t state){

	int ret=0;
	const char * const screen1 = "Demander vidage?";
	const char * const screen2 = "La benne est deja pleine !";
	const char * const screen3 = "La benne est deja vide !";
	const char * const screen4 = "Demande envoyee!";

	



	cfb_framebuffer_clear(display_dev, false);
	
	
	if(state == 0){
		display(display_dev, screen1, capabilities);
	}
	else if(state == 1){
		display3(display_dev, capabilities);
	}
	else if(state == 2){
		display(display_dev, screen4, capabilities);
	}
	else if(state == 3){
		if(vide == 0) 	vide = 1;
		else vide = 0;
		display_error(display_dev, vide, capabilities);
	}	
	k_sleep(K_MSEC(2000)); // pour l'uart via l'usb
	
}






void display(const struct device *display_dev, const char * const screen, struct display_capabilities capabilities){
	
	int ret = 0;
	
	ret = cfb_framebuffer_set_font(display_dev, 1);
	//printk("cfb_framebuffer_set_font1 %d\n", ret);
	if (cfb_print(display_dev, DUMPSTER_NAME, 88, 24)) {
		printk("Failed to print a string\n");
	}
	
	ret = cfb_framebuffer_set_font(display_dev, 1);
	//printk("cfb_framebuffer_set_font3 %d\n", ret);
	if (cfb_print(display_dev, screen, 0, 104)) {
		printk("Failed to print a string\n");
	}
	cfb_framebuffer_finalize(display_dev);
	
	display_logo(display_dev, capabilities);
}



void display3(const struct device *display_dev, struct display_capabilities capabilities){
	
	const char * const str2 = "Confirmez demande le";
	const char * const str3 = "27/07/2023";

	int ret = 0;
	
	ret = cfb_framebuffer_set_font(display_dev, 0);
	//printk("cfb_framebuffer_set_font1 %d\n", ret);
	if (cfb_print(display_dev, str2, 0, 8)) {
		printk("Failed to print a string\n");
	}

	ret = cfb_framebuffer_set_font(display_dev, 1);
	//printk("cfb_framebuffer_set_font2 %d\n", ret);
	if (cfb_print(display_dev, str3, 72, 56)) {
		printk("Failed to print a string\n");
	}
		
	cfb_framebuffer_finalize(display_dev);
		
	display_logo2(display_dev, capabilities);
}


void display_error(const struct device *display_dev, uint8_t state, struct display_capabilities capabilities){
	
	const char * const vide = "Vide";
	const char * const pleine = "Pleine";

	int ret = 0;
	
	ret = cfb_framebuffer_set_font(display_dev, 1);
	//printk("cfb_framebuffer_set_font1 %d\n", ret);
	if (cfb_print(display_dev, DUMPSTER_NAME, 88, 24)) {
		printk("Failed to print a string\n");
	}
	
	
	ret = cfb_framebuffer_set_font(display_dev, 0);
	//printk("cfb_framebuffer_set_font1 %d\n", ret);
	if (cfb_print(display_dev, "La benne est deja", 56, 56)) {
		printk("Failed to print a string\n");
	}
	
	if(state == 0){
		ret = cfb_framebuffer_set_font(display_dev, 0);
		//printk("cfb_framebuffer_set_font1 %d\n", ret);
		if (cfb_print(display_dev, vide, 56, 72)) {
			printk("Failed to print a string\n");
		}
	}
	else{
		ret = cfb_framebuffer_set_font(display_dev, 1);
		//printk("cfb_framebuffer_set_font2 %d\n", ret);
		if (cfb_print(display_dev, pleine, 56, 72)) {
			printk("Failed to print a string\n");
		}	
	}
			
	cfb_framebuffer_finalize(display_dev);
		
	display_logo2(display_dev, capabilities);
}


uint8_t state_display(){

	return stateDisplay;
}

void set_state_display(uint8_t state){
	stateDisplay = state;
}
