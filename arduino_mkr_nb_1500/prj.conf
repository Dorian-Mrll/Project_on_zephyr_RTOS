## prj.conf
```kconfig
# rediriger vers la console
CONFIG_PRINTK=y
CONFIG_STDOUT_CONSOLE=y




# active pile de peripherique USB
CONFIG_USB_DEVICE_STACK=y
# emuler modem
CONFIG_USB_CDC_ACM=y


# active l'uart
CONFIG_SERIAL=y
CONFIG_CONSOLE=y








# active console uart
CONFIG_UART_CONSOLE=y
CONFIG_GPIO=y
CONFIG_I2C=y
# Enable SPI
CONFIG_SPI=y

 
# recuperer valeur envoye depuis la console
CONFIG_CONSOLE_SUBSYS=y
CONFIG_CONSOLE_GETLINE=y

 
CONFIG_LOG=y
CONFIG_DISPLAY_LOG_LEVEL_ERR=y



# permet d'utiliser cfb
CONFIG_CHARACTER_FRAMEBUFFER=y


# allouer mémoire dynamiquement pour le programme (en octets)
CONFIG_HEAP_MEM_POOL_SIZE=16384


#Enable display controller
CONFIG_SSD16XX=y
CONFIG_DISPLAY=y


#CONFIG_NETWORKING=y
#CONFIG_NET_SOCKETS=y

# GSM modem configuration
#CONFIG_MODEM=y
#CONFIG_MODEM_UBLOX_SARA=y
#CONFIG_MODEM_UBLOX_SARA_R4=y
#CONFIG_MODEM_UBLOX_SARA_R4_APN="orange.m2m.spec"


#CONFIG_TEST_RANDOM_GENERATOR=y


#CONFIG_LVGL=y

#CONFIG_MAIN_STACK_SIZE=2048

#CONFIG_LV_MEM_CUSTOM=y
#CONFIG_LV_USE_LOG=y
#CONFIG_LV_USE_LABEL=y
#CONFIG_LV_USE_BTN=y
#CONFIG_LV_USE_IMG=y
#CONFIG_LV_FONT_MONTSERRAT_14=y

 

#CONFIG_LV_Z_BITS_PER_PIXEL=1
#CONFIG_LV_Z_MEM_POOL_NUMBER_BLOCKS=8
#CONFIG_APP_LINK_WITH_LVGL=y


#CONFIG_LV_USE_THEME_DEFAULT=y
#CONFIG_LV_Z_VDB_SIZE=64
#CONFIG_LV_COLOR_DEPTH_1=y

 
```

## src/main.c
```c
#include "functions.h"



//uart
//const struct device *uart_debug = DEVICE_DT_GET(DT_NODELABEL(sercom5));
const struct device *uart_debug = DEVICE_DT_GET(DT_CHOSEN(zephyr_console));
const struct device *uart_modem_sara = DEVICE_DT_GET(DT_NODELABEL(sercom2));

//i2c
//const struct device *i2c_dev = DEVICE_DT_GET(DT_NODELABEL(sercom3));




const struct device *display_dev;
const struct display_capabilities capabilities;


#define DELAY_MS 5000




void main(void)
{
	if (usb_enable(NULL)) {
		return;
	}
	
	//display_dev = DEVICE_DT_GET(DT_CHOSEN(zephyr_display));
	//init_eink_display(display_dev, capabilities);



	// Sleep to wait for a terminal connection.
	k_sleep(K_MSEC(500)); // pour l'uart via l'usb
	

	printk("MESSAGE DE TEST\n");
		
	
	
	
	/*uint8_t last_display = 0;
	
	display_text(display_dev, capabilities, 1);
	init_button();


	while(1){
	
		printk("state_display %d\n", state_display());
	
		if(state_display() == 0 && last_display != 0){
		
			last_display = 0;
			display_text(display_dev, capabilities, 0);
		}
		else if(state_display() == 1 && last_display != 1){
		
			last_display = 1;
			display_text(display_dev, capabilities, 1);
		}
		else if(state_display() == 2 && last_display != 2){
		
			last_display = 2;
			display_text(display_dev, capabilities, 2);
			
			while(state_display() != 3)		
			

			tempsEcoule = k_uptime_get_32() - debut;

			printf("Temps écoulé : %u ms\n", tempsEcoule);

			if (tempsEcoule >= DELAY_MS) {
			// Effectuer l'action après le délai de 2 secondes
			printf("Action exécutée après 2 secondes !\n");
			set_state_display(0);
			// Réinitialiser le compteur pour le prochain délai
			debut = k_uptime_get_32();
			break;
			}
			
			
			
			set_state_display(0);
		}
		else if(state_display() == 3 && last_display != 3){
		
			last_display = 3;
			display_text(display_dev, capabilities, 3);
			
			k_sleep(K_MSEC(5000)); // pour l'uart via l'usb
					
			set_state_display(0);
		}
		
		
		k_sleep(K_MSEC(2000)); // pour l'uart via l'usb
	}*/

	
	
	//blink();
	
	if(init_module_sara(uart_debug, uart_modem_sara))
//		read_write_cellular_data(uart_debug, uart_modem_sara);
	
		mqtt();
	
	//i2c_scanner(i2c_dev);
	
	//init_module_eva(i2c_dev);
	
	//read_gps_data(i2c_dev);
			
}
```

## include/functions.h
```c
#ifndef FUNCTION_H
#define FUNCTION_H


#include <zephyr/kernel.h>
#include <zephyr/device.h>
#include <zephyr/devicetree.h>
#include <zephyr/drivers/gpio.h>
#include <zephyr/drivers/uart.h>
#include <zephyr/drivers/i2c.h>
#include <zephyr/drivers/spi.h>


#include <zephyr/sys/printk.h>
#include <zephyr/console/console.h>


#include <zephyr/drivers/display.h>
#include <zephyr/display/cfb.h>


#include <stdio.h>
#include <string.h>


#include <zephyr/sys/util.h>

#include <zephyr/usb/usb_device.h>

// liste des commandes possibles pouvant êtres envoyées
static const uint8_t at_cmd_map[][20] = {
    "AT",
    "AT+CGPADDR",
    "AT+CGMR",
    "AT+CGMI",
    "ATI",
    "AT+CGDCONT?",
    "AT+CGCONTRDP",
    "AT+COPS?",
    "AT+CREG?",
};



// uart

// const struct uart_config uart_cfg = {
// 		.baudrate = 115200,
// 		.parity = UART_CFG_PARITY_NONE,
// 		.stop_bits = UART_CFG_STOP_BITS_1,
// 		.data_bits = UART_CFG_DATA_BITS_8,
// 		.flow_ctrl = UART_CFG_FLOW_CTRL_NONE
// };


#define DUMPSTER_NAME "17m3 BOIS"

void blink(void);


int test_device(const struct device *uart_dev);


int init_module_sara(const struct device *uart_debug, const struct device *uart_modem_sara);
int read_write_cellular_data(const struct device *uart_debug, const struct device *uart_modem_sara);

int test_poll_in(const struct device *uart_debug, const struct device *uart_modem_sara);
int test_poll_out(const struct device *uart_modem_sara, uint8_t *poll_data);

int init_module_eva(const struct device *i2c_dev);
void read_gps_data(const struct device *i2c_dev);
void config_gps(const struct device *i2c_dev);

int i2c_scanner(const struct device *i2c_dev);

void test_gpio(void);



void init_eink_display(const struct device *display_dev, struct display_capabilities capabilities);

void display_text(const struct device *display_dev, struct display_capabilities capabilities, uint8_t state);


void display(const struct device *display_dev, const char * const screen, struct display_capabilities capabilities);
void display2(const struct device *display_dev, struct display_capabilities capabilities);
void display3(const struct device *display_dev, struct display_capabilities capabilities);
void display_error(const struct device *display_dev, uint8_t state, struct display_capabilities capabilities);


void display_logo(const struct device *display_dev, struct display_capabilities capabilities);



uint8_t state_display();
void set_state_display(uint8_t state);


void init_button(void);

void button_pressed(const struct device *dev, struct gpio_callback *cb, uint32_t pins);
void button2_pressed(const struct device *dev, struct gpio_callback *cb, uint32_t pins);

#endif
```

## src/button.c
```c
#include "functions.h"


#define SW0_NODE	DT_ALIAS(sw0)
#define SW1_NODE	DT_ALIAS(sw1)


#define DEBOUNCE_TIMEOUT_MS 50


static const struct gpio_dt_spec back = GPIO_DT_SPEC_GET_OR(SW0_NODE, gpios, {0});
static const struct gpio_dt_spec next = GPIO_DT_SPEC_GET_OR(SW1_NODE, gpios, {0});
							      
static struct gpio_callback button_cb_data;
static struct gpio_callback button_cb_data2;


uint64_t last_time = 0;
uint64_t last_time2 = 0;


void back_pressed(const struct device *dev, struct gpio_callback *cb,
		    uint32_t pins)
{
	
  uint64_t now = k_uptime_get();
  if ((now - last_time) > DEBOUNCE_TIMEOUT_MS)
  {
  
    	/*printk("BOUTON 1 START\n");
	printk("Button 1 pressed at %" PRIu32 "\n", k_cycle_get_32());
	printk("BOUTON 1 END\n");*/
	
	if(state_display() == 1){
		set_state_display(0);
	}
	else if(state_display() == 2){
		set_state_display(1);
	}
	else if(state_display() == 3){
		set_state_display(2);
	}
  }
  last_time = now;
}


void next_pressed(const struct device *dev, struct gpio_callback *cb,
		    uint32_t pins)
{
	uint64_t now = k_uptime_get();
  if ((now - last_time2) > DEBOUNCE_TIMEOUT_MS)
  {
  	
    	/*printk("BOUTON 2 START\n");
	printk("Button 2 pressed at %" PRIu32 "\n", k_cycle_get_32());
	printk("BOUTON 2 END\n");*/
	
	if(state_display() == 0){
		set_state_display(1);
	}
	else if(state_display() == 1){
		set_state_display(2);
	}
	else if(state_display() == 2){
		set_state_display(3);
	}
  }
  last_time2 = now;
}


void init_button(){

	int ret;

	if (!gpio_is_ready_dt(&back)) {
		printk("Error: back device %s is not ready\n",
		       back.port->name);
		return;
	}
	
	ret = gpio_pin_configure_dt(&back, GPIO_INPUT);
	if (ret != 0) {
		printk("Error %d: failed to configure %s pin %d\n",
		       ret, back.port->name, back.pin);
		return;
	}
	
	ret = gpio_pin_interrupt_configure_dt(&back,
					      GPIO_INT_EDGE_TO_ACTIVE);
	if (ret != 0) {
		printk("Error %d: failed to configure interrupt on %s pin %d\n",
			ret, back.port->name, back.pin);
		return;
	}
	
	
	if (!gpio_is_ready_dt(&next)) {
		printk("Error: back device %s is not ready\n",
		       next.port->name);
		return;
	}
	
	ret = gpio_pin_configure_dt(&next, GPIO_INPUT);
	if (ret != 0) {
		printk("Error %d: failed to configure %s pin %d\n",
		       ret, next.port->name, next.pin);
		return;
	}

	ret = gpio_pin_interrupt_configure_dt(&next,
					      GPIO_INT_EDGE_TO_ACTIVE);
	if (ret != 0) {
		printk("Error %d: failed to configure interrupt on %s pin %d\n",
			ret, next.port->name, next.pin);
		return;
	}
	
	gpio_init_callback(&button_cb_data, back_pressed, BIT(back.pin));
	gpio_add_callback(back.port, &button_cb_data);
	printk("Set up back at %s pin %d\n", back.port->name, back.pin);
	
	
	gpio_init_callback(&button_cb_data2, next_pressed, BIT(next.pin));
	gpio_add_callback(next.port, &button_cb_data2);
	printk("Set up back 2 at %s pin %d\n", next.port->name, next.pin);
}
```

## src/display.c
```c
#include "functions.h"
#include <zephyr/display/ssd16xx.h>

#include <zephyr/logging/log.h>
LOG_MODULE_REGISTER(sample, LOG_LEVEL_INF);


#ifdef CONFIG_ARCH_POSIX
#include "posix_board_if.h"
#endif

#ifdef CONFIG_ARCH_POSIX
#define RETURN_FROM_MAIN(exit_code) posix_exit_main(exit_code)
#else
#define RETURN_FROM_MAIN(exit_code) return
#endif





#ifdef CONFIG_ARCH_POSIX
static void posix_exit_main(int exit_code)
{
#if CONFIG_TEST
	if (exit_code == 0) {
		LOG_INF("PROJECT EXECUTION SUCCESSFUL");
	} else {
		LOG_INF("PROJECT EXECUTION FAILED");
	}
#endif
	posix_exit(exit_code);
}
#endif


uint8_t stateDisplay = 0;


// 'paprec_logotype_72', 72x72px
static const uint8_t  image_data2[] = {
0xff, 0xff, 0xff, 0xff, 0xff, 0xff, 0xff, 0xff, 0xff, 0xff, 0xff, 0xff, 0xff, 0xff, 0xff, 0xff, 
0xfe, 0xfc, 0xfc, 0xf8, 0xf8, 0xf1, 0xf3, 0xe3, 0xe3, 0xe7, 0xc7, 0xcf, 0xcf, 0xcf, 0x8f, 0x8f, 
0x9f, 0x9f, 0x9f, 0x9f, 0x9f, 0x9f, 0x9f, 0x9f, 0x8f, 0x8f, 0xcf, 0xcf, 0xcf, 0xc7, 0xc7, 0xe7, 
0xe3, 0xf3, 0xf1, 0xf1, 0xf8, 0xfc, 0xfc, 0xfe, 0xfe, 0xff, 0xff, 0xff, 0xff, 0xff, 0xff, 0xff, 
0xff, 0xff, 0xff, 0xff, 0xff, 0xff, 0xff, 0xff, 0xff, 0xff, 0xff, 0xff, 0xff, 0xff, 0xff, 0xfe, 
0xfc, 0xf8, 0xf0, 0xe0, 0xc0, 0x80, 0x00, 0x00, 0x00, 0x00, 0x00, 0x00, 0x00, 0x00, 0x00, 0x00, 
0x00, 0x80, 0xc0, 0xe0, 0xf0, 0xf8, 0xfc, 0xff, 0xff, 0xff, 0xff, 0xff, 0xff, 0xff, 0xff, 0xff, 
0xff, 0xff, 0xff, 0xff, 0xff, 0xff, 0xff, 0xff, 0xff, 0xff, 0xff, 0xff, 0xff, 0xfe, 0x7c, 0x38, 
0x30, 0x10, 0x80, 0xc0, 0xe0, 0xf0, 0xf8, 0xfc, 0xfe, 0xff, 0xff, 0xff, 0xff, 0xff, 0xff, 0xff, 
0xff, 0xff, 0xff, 0xfe, 0xf0, 0xe0, 0x80, 0x00, 0x00, 0x00, 0x00, 0x00, 0x00, 0x00, 0x00, 0x00, 
0x00, 0x00, 0x00, 0x00, 0x00, 0x00, 0x00, 0x00, 0x00, 0x00, 0x00, 0x00, 0x00, 0x00, 0x00, 0x83, 
0xff, 0xff, 0xff, 0xff, 0xff, 0xff, 0xff, 0xff, 0xff, 0xff, 0xff, 0xff, 0xff, 0xff, 0xff, 0xff, 
0xff, 0xff, 0xf0, 0xc0, 0x00, 0x00, 0x00, 0x00, 0x00, 0x00, 0x00, 0x00, 0x00, 0x00, 0x00, 0x00, 
0x00, 0x80, 0xc0, 0xf0, 0xfc, 0xff, 0xff, 0xff, 0xff, 0xf8, 0x80, 0x00, 0x00, 0x00, 0x00, 0x00, 
0x00, 0x00, 0x00, 0x00, 0x00, 0x00, 0x00, 0x00, 0x00, 0x00, 0x00, 0x00, 0x00, 0x00, 0x00, 0x00, 
0x00, 0x00, 0x00, 0x00, 0x00, 0xfc, 0xfe, 0xff, 0xff, 0xff, 0xff, 0xff, 0xff, 0xff, 0xff, 0xff, 
0xff, 0xff, 0xff, 0xff, 0xff, 0xff, 0xff, 0xff, 0xff, 0xff, 0xff, 0x1f, 0x1f, 0x1f, 0x06, 0x00, 
0x00, 0x00, 0x00, 0x00, 0x00, 0x00, 0x00, 0x00, 0x00, 0x00, 0x00, 0x00, 0x00, 0x80, 0xf8, 0xff, 
0xff, 0x00, 0x00, 0x00, 0x00, 0x00, 0x00, 0x00, 0x00, 0x00, 0x00, 0x00, 0x00, 0x00, 0x00, 0x00, 
0x00, 0x00, 0x00, 0x00, 0x00, 0x00, 0x00, 0x00, 0x00, 0x00, 0x00, 0x00, 0x00, 0x00, 0x00, 0x00, 
0x80, 0xc0, 0xc0, 0xe1, 0xe3, 0xff, 0xff, 0xff, 0xff, 0xff, 0xff, 0xff, 0xff, 0xff, 0xff, 0xff, 
0xff, 0xff, 0xff, 0xff, 0xff, 0x1f, 0x0f, 0x03, 0x00, 0x00, 0x00, 0x00, 0x00, 0x00, 0x00, 0x00, 
0x00, 0x00, 0x00, 0x00, 0x00, 0x00, 0x00, 0xff, 0xff, 0x1f, 0x01, 0x00, 0x00, 0x00, 0x00, 0x00, 
0x00, 0x00, 0x00, 0x00, 0x00, 0x00, 0x00, 0x00, 0x00, 0x00, 0x00, 0x00, 0x00, 0x00, 0x00, 0x00, 
0x00, 0x00, 0x00, 0x00, 0x00, 0x00, 0x00, 0x00, 0x00, 0x00, 0x00, 0x80, 0xc6, 0xff, 0xff, 0xff, 
0xff, 0xff, 0xff, 0xff, 0xff, 0xff, 0xff, 0xff, 0xff, 0xff, 0xff, 0xff, 0xff, 0xff, 0xff, 0xff, 
0x7f, 0x0f, 0x0f, 0x0f, 0x0f, 0x0f, 0x0f, 0x0f, 0x0f, 0x0f, 0x07, 0x00, 0x00, 0x01, 0x1f, 0xff, 
0xff, 0xff, 0xff, 0x7f, 0x0f, 0x03, 0x01, 0x00, 0x00, 0x00, 0x00, 0x00, 0x00, 0x00, 0x00, 0x00, 
0x00, 0x00, 0x00, 0x00, 0x00, 0x00, 0x00, 0x00, 0x00, 0x00, 0x00, 0x00, 0x00, 0x00, 0x00, 0x00, 
0x00, 0x00, 0x00, 0x00, 0x20, 0x78, 0xff, 0xff, 0xff, 0xff, 0xff, 0xff, 0xff, 0xff, 0xff, 0xff, 
0xff, 0xff, 0xff, 0xff, 0xff, 0xff, 0xff, 0xff, 0xff, 0xff, 0xff, 0xff, 0xff, 0xff, 0xfe, 0xfc, 
0xf0, 0xe1, 0x03, 0x0f, 0x3f, 0xff, 0xff, 0xff, 0xff, 0xff, 0xff, 0xff, 0xff, 0xff, 0xff, 0x7f, 
0x3f, 0x1f, 0x0f, 0x07, 0x03, 0x01, 0x00, 0x00, 0x00, 0x00, 0x00, 0x00, 0x00, 0x00, 0x01, 0x03, 
0x07, 0x07, 0x07, 0x0f, 0x0f, 0x0f, 0x0f, 0x0f, 0x0f, 0x1f, 0x1f, 0x1f, 0x3f, 0x7f, 0xff, 0xff, 
0xff, 0xff, 0xff, 0xff, 0xff, 0xff, 0xff, 0xff, 0xff, 0xff, 0xff, 0xff, 0xff, 0xff, 0xfe, 0xfc, 
0xfc, 0xf8, 0xf1, 0xe3, 0xc7, 0x8f, 0x1f, 0x3f, 0x7f, 0xff, 0xff, 0xff, 0xff, 0xff, 0xff, 0xff, 
0xff, 0xff, 0xff, 0xff, 0xff, 0xff, 0xff, 0xff, 0xff, 0xff, 0xff, 0xff, 0xff, 0xff, 0xff, 0x7f, 
0x7f, 0x3f, 0x3f, 0x1f, 0x0f, 0x0f, 0xcf, 0xc7, 0xe7, 0xe3, 0xe3, 0xf3, 0xf3, 0xf1, 0xf1, 0xf9, 
0xf9, 0xf9, 0xf9, 0xf9, 0xf9, 0xf9, 0xf9, 0xf9, 0xf9, 0xf1, 0xf1, 0xf3, 0xf3, 0xe3, 0xe3, 0xe7, 
0xc7, 0xc7, 0x8f, 0x8f, 0x1f, 0x1f, 0x3f, 0x7f, 0x7f, 0xff, 0xff, 0xff, 0xff, 0xff, 0xff, 0xff, 
0xff, 0xff, 0xff, 0xff, 0xff, 0xff, 0xff, 0xff
};
 
 
 
// 'paprec_logotype_48', 48x48px
static const uint8_t  image_data[] = {
0xff, 0xff, 0xff, 0xff, 0xff, 0xff, 0xff, 0xff, 0xfc, 0xfc, 0xf8, 0xe0, 0xe0, 0xe0, 0xc8, 0xdc, 
0x9c, 0x9c, 0x9e, 0xbf, 0xbf, 0xbf, 0xbf, 0xbf, 0xbf, 0xbf, 0xbf, 0x9f, 0x9f, 0x9f, 0x9f, 0x9f, 
0xcf, 0xcf, 0xc7, 0xe3, 0xf3, 0xf9, 0xfc, 0xfc, 0xff, 0xff, 0xff, 0xff, 0xff, 0xff, 0xff, 0xff, 
0xff, 0xff, 0xfc, 0xf0, 0xc0, 0x80, 0x00, 0x00, 0x00, 0x00, 0x00, 0x00, 0x00, 0x00, 0x00, 0x00, 
0x00, 0x00, 0x00, 0x80, 0xe3, 0xff, 0xff, 0xff, 0xff, 0xff, 0xff, 0xff, 0xff, 0xff, 0xff, 0xff, 
0xff, 0xfc, 0xe0, 0xc0, 0x80, 0x00, 0x00, 0x00, 0x00, 0x00, 0xc0, 0xe0, 0xf8, 0xfe, 0xff, 0xff, 
0xff, 0x00, 0x00, 0x00, 0x00, 0x00, 0x00, 0x00, 0x00, 0x00, 0x00, 0x00, 0x00, 0x00, 0x00, 0x00, 
0x00, 0x00, 0x00, 0xf0, 0xf8, 0xfc, 0xfc, 0xfe, 0xff, 0xff, 0xff, 0xff, 0xff, 0xff, 0xff, 0xff, 
0xff, 0xff, 0x3f, 0x3f, 0x00, 0x00, 0x00, 0x00, 0x00, 0x00, 0x00, 0x00, 0x00, 0x00, 0xc0, 0xff, 
0xff, 0x01, 0x00, 0x00, 0x00, 0x00, 0x00, 0x00, 0x00, 0x00, 0x00, 0x00, 0x00, 0x00, 0x00, 0x00, 
0x00, 0x00, 0x00, 0x00, 0x00, 0x00, 0x00, 0x00, 0x73, 0xff, 0xff, 0xff, 0xff, 0xff, 0xff, 0xff, 
0xff, 0xff, 0xff, 0xff, 0xff, 0x0f, 0x07, 0x07, 0x07, 0x07, 0x07, 0x07, 0x00, 0x00, 0x03, 0xff, 
0xff, 0xff, 0x3f, 0x1f, 0x07, 0x03, 0x00, 0x00, 0x00, 0x00, 0x00, 0x00, 0x00, 0x00, 0x00, 0x00, 
0x00, 0x00, 0x00, 0x00, 0x00, 0x01, 0x01, 0x01, 0xe3, 0xff, 0xff, 0xff, 0xff, 0xff, 0xff, 0xff, 
0xff, 0xff, 0xff, 0xff, 0xff, 0xff, 0xff, 0xff, 0xfc, 0xf8, 0xe3, 0x87, 0x1f, 0x3f, 0xff, 0xff, 
0xff, 0xff, 0xff, 0xff, 0xff, 0xff, 0xff, 0xff, 0x3f, 0x3f, 0x1f, 0x0f, 0x0f, 0x07, 0x27, 0x73, 
0x73, 0x79, 0xf9, 0xf9, 0xf9, 0xf9, 0xf9, 0xf9, 0xf9, 0xf9, 0xf9, 0xf9, 0xf9, 0xfb, 0xf3, 0xf3, 
0xf7, 0xe7, 0xc7, 0xcf, 0xcf, 0x9f, 0x3f, 0x3f, 0xff, 0xff, 0xff, 0xff, 0xff, 0xff, 0xff, 0xff
};
 

uint8_t vide = 0;

void display_logo(const struct device *display_dev, struct display_capabilities capabilities){
		
	size_t x;
	size_t y;
	size_t rect_w;
	size_t rect_h;
	size_t h_step;
	size_t scale;

	uint8_t *buf;


	struct display_buffer_descriptor buf_desc;
	size_t buf_size = 0;

	if (capabilities.screen_info & SCREEN_INFO_MONO_VTILED) {
		rect_w = 16;
		rect_h = 8;
	} else {
		rect_w = 2;
		rect_h = 1;
	}


	/*printk("rect_w %d\n", rect_w);
	printk("rect_h %d\n", rect_h);*/

	h_step = rect_h;
	scale = (capabilities.x_resolution / 8) / rect_h;

	rect_w *= scale;
	rect_h *= scale;
	
	/*printk("rect_w %d\n", rect_w);
	printk("rect_h %d\n", rect_h);*/


	buf_size = rect_w * rect_h;

	if (buf_size < (capabilities.x_resolution * h_step)) {
		buf_size = capabilities.x_resolution * h_step;
	}


	//printk("buf_size %d\n", buf_size);
	buf_size /= 8;
	//printk("buf_size %d\n", buf_size);

	buf = k_malloc(buf_size);

	if (buf == NULL) {
		//LOG_ERR("Could not allocate memory. Aborting sample.");
		RETURN_FROM_MAIN(1);
	}

	(void)memset(buf, 0xFF, buf_size);



	
			
	buf_desc.buf_size = buf_size;
	buf_desc.pitch = capabilities.x_resolution;
	buf_desc.width = capabilities.x_resolution;
	buf_desc.height = h_step;
	
	/*printk("buf_desc.buf_size %d\n", buf_desc.buf_size);
	printk("buf_desc.pitch %d\n", buf_desc.pitch);
	printk("buf_desc.width %d\n", buf_desc.width);
	printk("buf_desc.height %d\n", buf_desc.height);*/
	



	buf_desc.pitch = rect_w;
	buf_desc.width = rect_w;
	buf_desc.height = rect_h;
	
	
	/*printk("buf_desc.buf_size %d\n", buf_desc.buf_size);
	printk("buf_desc.pitch %d\n", buf_desc.pitch);
	printk("buf_desc.width %d\n", buf_desc.width);
	printk("buf_desc.height %d\n", buf_desc.height);*/
	

	memset(buf, 0, buf_size);
	
	
	buf_desc.buf_size = 648;
	buf_desc.pitch = 72;
	buf_desc.width = 72;
	buf_desc.height = 72;


	//TOP_LEFT
	//printk("buf_size %d\n", buf_size);
	//x = capabilities.x_resolution - rect_w;
	x = 176;
	y = 8;
	display_write(display_dev, x, y, &buf_desc, image_data2);
}

void display_logo2(const struct device *display_dev, struct display_capabilities capabilities){
		
	size_t x;
	size_t y;
	size_t rect_w;
	size_t rect_h;
	size_t h_step;
	size_t scale;

	uint8_t *buf;


	struct display_buffer_descriptor buf_desc;
	size_t buf_size = 0;

	if (capabilities.screen_info & SCREEN_INFO_MONO_VTILED) {
		rect_w = 16;
		rect_h = 8;
	} else {
		rect_w = 2;
		rect_h = 1;
	}


	/*printk("rect_w %d\n", rect_w);
	printk("rect_h %d\n", rect_h);*/

	h_step = rect_h;
	scale = (capabilities.x_resolution / 8) / rect_h;

	rect_w *= scale;
	rect_h *= scale;
	
	/*printk("rect_w %d\n", rect_w);
	printk("rect_h %d\n", rect_h);*/


	buf_size = rect_w * rect_h;

	if (buf_size < (capabilities.x_resolution * h_step)) {
		buf_size = capabilities.x_resolution * h_step;
	}


	//printk("buf_size %d\n", buf_size);
	buf_size /= 8;
	//printk("buf_size %d\n", buf_size);

	buf = k_malloc(buf_size);

	if (buf == NULL) {
		//LOG_ERR("Could not allocate memory. Aborting sample.");
		RETURN_FROM_MAIN(1);
	}

	(void)memset(buf, 0xFF, buf_size);



	
			
	buf_desc.buf_size = buf_size;
	buf_desc.pitch = capabilities.x_resolution;
	buf_desc.width = capabilities.x_resolution;
	buf_desc.height = h_step;
	
	/*printk("buf_desc.buf_size %d\n", buf_desc.buf_size);
	printk("buf_desc.pitch %d\n", buf_desc.pitch);
	printk("buf_desc.width %d\n", buf_desc.width);
	printk("buf_desc.height %d\n", buf_desc.height);*/
	



	buf_desc.pitch = rect_w;
	buf_desc.width = rect_w;
	buf_desc.height = rect_h;
	
	
	/*printk("buf_desc.buf_size %d\n", buf_desc.buf_size);
	printk("buf_desc.pitch %d\n", buf_desc.pitch);
	printk("buf_desc.width %d\n", buf_desc.width);
	printk("buf_desc.height %d\n", buf_desc.height);*/
	

	memset(buf, 0, buf_size);
	
	
	/*buf_desc.buf_size = 648;
	buf_desc.pitch = 72;
	buf_desc.width = 72;
	buf_desc.height = 72;*/
	
	buf_desc.buf_size = 288;
	buf_desc.pitch = 48;
	buf_desc.width = 48;
	buf_desc.height = 48;


	//TOP_LEFT
	//printk("buf_size %d\n", buf_size);
	//x = capabilities.x_resolution - rect_w;
	x = 184;
	y = 40;
	display_write(display_dev, x, y, &buf_desc, image_data);
}




void init_eink_display(const struct device *display_dev, struct display_capabilities capabilities){

	if (!device_is_ready(display_dev)) {
		LOG_ERR("Device %s not found. Aborting sample.",
			display_dev->name);
		RETURN_FROM_MAIN(1);
	}

	LOG_INF("Display sample for %s", display_dev->name);
	display_get_capabilities(display_dev, &capabilities);
	
	if (cfb_framebuffer_init(display_dev)) {
		printk("Framebuffer initialization failed!\n");
		return;
	}
	
	cfb_framebuffer_clear(display_dev, true);
	display_blanking_off(display_dev);

}


void display_text(const struct device *display_dev, struct display_capabilities capabilities, uint8_t state){

	int ret=0;
	const char * const screen1 = "Demander vidage?";
	const char * const screen2 = "La benne est deja pleine !";
	const char * const screen3 = "La benne est deja vide !";
	const char * const screen4 = "Demande envoyee!";

	



	cfb_framebuffer_clear(display_dev, false);
	
	
	if(state == 0){
		display(display_dev, screen1, capabilities);
	}
	else if(state == 1){
		display3(display_dev, capabilities);
	}
	else if(state == 2){
		display(display_dev, screen4, capabilities);
	}
	else if(state == 3){
		if(vide == 0) 	vide = 1;
		else vide = 0;
		display_error(display_dev, vide, capabilities);
	}	
	k_sleep(K_MSEC(2000)); // pour l'uart via l'usb
	
}






void display(const struct device *display_dev, const char * const screen, struct display_capabilities capabilities){
	
	int ret = 0;
	
	ret = cfb_framebuffer_set_font(display_dev, 1);
	//printk("cfb_framebuffer_set_font1 %d\n", ret);
	if (cfb_print(display_dev, DUMPSTER_NAME, 88, 24)) {
		printk("Failed to print a string\n");
	}
	
	ret = cfb_framebuffer_set_font(display_dev, 1);
	//printk("cfb_framebuffer_set_font3 %d\n", ret);
	if (cfb_print(display_dev, screen, 0, 104)) {
		printk("Failed to print a string\n");
	}
	cfb_framebuffer_finalize(display_dev);
	
	display_logo(display_dev, capabilities);
}



void display3(const struct device *display_dev, struct display_capabilities capabilities){
	
	const char * const str2 = "Confirmez demande le";
	const char * const str3 = "27/07/2023";

	int ret = 0;
	
	ret = cfb_framebuffer_set_font(display_dev, 0);
	//printk("cfb_framebuffer_set_font1 %d\n", ret);
	if (cfb_print(display_dev, str2, 0, 8)) {
		printk("Failed to print a string\n");
	}

	ret = cfb_framebuffer_set_font(display_dev, 1);
	//printk("cfb_framebuffer_set_font2 %d\n", ret);
	if (cfb_print(display_dev, str3, 72, 56)) {
		printk("Failed to print a string\n");
	}
		
	cfb_framebuffer_finalize(display_dev);
		
	display_logo2(display_dev, capabilities);
}


void display_error(const struct device *display_dev, uint8_t state, struct display_capabilities capabilities){
	
	const char * const vide = "Vide";
	const char * const pleine = "Pleine";

	int ret = 0;
	
	ret = cfb_framebuffer_set_font(display_dev, 1);
	//printk("cfb_framebuffer_set_font1 %d\n", ret);
	if (cfb_print(display_dev, DUMPSTER_NAME, 88, 24)) {
		printk("Failed to print a string\n");
	}
	
	
	ret = cfb_framebuffer_set_font(display_dev, 0);
	//printk("cfb_framebuffer_set_font1 %d\n", ret);
	if (cfb_print(display_dev, "La benne est deja", 56, 56)) {
		printk("Failed to print a string\n");
	}
	
	if(state == 0){
		ret = cfb_framebuffer_set_font(display_dev, 0);
		//printk("cfb_framebuffer_set_font1 %d\n", ret);
		if (cfb_print(display_dev, vide, 56, 72)) {
			printk("Failed to print a string\n");
		}
	}
	else{
		ret = cfb_framebuffer_set_font(display_dev, 1);
		//printk("cfb_framebuffer_set_font2 %d\n", ret);
		if (cfb_print(display_dev, pleine, 56, 72)) {
			printk("Failed to print a string\n");
		}	
	}
			
	cfb_framebuffer_finalize(display_dev);
		
	display_logo2(display_dev, capabilities);
}


uint8_t state_display(){

	return stateDisplay;
}

void set_state_display(uint8_t state){
	stateDisplay = state;
}
```

## src/i2c_scanner.c
```c
#include "functions.h"
/*
#define I2C_ADDR_MIN 0x08 // Adresse minimale à scanner
#define I2C_ADDR_MAX 0x77 // Adresse maximale à scanner


int i2c_scanner(const struct device *i2c_dev)
{

    if(!test_device(i2c_dev)) return -1;
    if(!init_module_eva(i2c_dev)) return -1;
    
    int ret;
    struct i2c_msg msg;
    uint8_t dummy_byte = 0;
    int i2c_addr;

    printf("Scanning des adresses I2C...\n");

    for (i2c_addr = I2C_ADDR_MIN; i2c_addr <= I2C_ADDR_MAX; i2c_addr++) {
        msg.flags = I2C_MSG_WRITE | I2C_MSG_STOP;
        msg.len = 1;
        msg.buf = &dummy_byte;

        ret = i2c_transfer(i2c_dev, &msg, 1, i2c_addr);
        if (ret == 0) {
            printf("Adresse I2C détectée: 0x%x\n", i2c_addr);
        }
		//printf("ret: %d\n", ret);
    }

    printf("Terminé.\n");
    return 1;
}
*/
```

## src/mqtt.c
```c
#include "functions.h"


#include <zephyr/net/mqtt.h>



#define SERVER_ADDR "91.121.93.94"  // Remplacez par l'adresse IP réelle
#define SERVER_PORT 1883
#define CLIENT_ID "zephyr_mqtt_publisher"
#define TOPIC_NAME "mqtt/testZephyr"




/*
 * Copyright (c) 2017 Intel Corporation
 *
 * SPDX-License-Identifier: Apache-2.0
 */

#include <zephyr/logging/log.h>
LOG_MODULE_REGISTER(net_mqtt_publisher_sample, LOG_LEVEL_DBG);

#include <zephyr/kernel.h>
#include <zephyr/net/socket.h>
#include <zephyr/net/mqtt.h>
#include <zephyr/random/rand32.h>

#include <string.h>
#include <errno.h>

#include "config.h"

#if defined(CONFIG_USERSPACE)
#include <zephyr/app_memory/app_memdomain.h>
K_APPMEM_PARTITION_DEFINE(app_partition);
struct k_mem_domain app_domain;
#define APP_BMEM K_APP_BMEM(app_partition)
#define APP_DMEM K_APP_DMEM(app_partition)
#else
#define APP_BMEM
#define APP_DMEM
#endif

/* Buffers for MQTT client. */
static APP_BMEM uint8_t rx_buffer[APP_MQTT_BUFFER_SIZE];
static APP_BMEM uint8_t tx_buffer[APP_MQTT_BUFFER_SIZE];

#if defined(CONFIG_MQTT_LIB_WEBSOCKET)
/* Making RX buffer large enough that the full IPv6 packet can fit into it */
#define MQTT_LIB_WEBSOCKET_RECV_BUF_LEN 1280

/* Websocket needs temporary buffer to store partial packets */
static APP_BMEM uint8_t temp_ws_rx_buf[MQTT_LIB_WEBSOCKET_RECV_BUF_LEN];
#endif

/* The mqtt client struct */
static APP_BMEM struct mqtt_client client_ctx;

/* MQTT Broker details. */
static APP_BMEM struct sockaddr_storage broker;

#if defined(CONFIG_SOCKS)
static APP_BMEM struct sockaddr socks5_proxy;
#endif

static APP_BMEM struct zsock_pollfd fds[1];
static APP_BMEM int nfds;

static APP_BMEM bool connected;

#if defined(CONFIG_MQTT_LIB_TLS)

#include "test_certs.h"

#define TLS_SNI_HOSTNAME "localhost"
#define APP_CA_CERT_TAG 1
#define APP_PSK_TAG 2

static APP_DMEM sec_tag_t m_sec_tags[] = {
#if defined(MBEDTLS_X509_CRT_PARSE_C) || defined(CONFIG_NET_SOCKETS_OFFLOAD)
		APP_CA_CERT_TAG,
#endif
#if defined(MBEDTLS_KEY_EXCHANGE_SOME_PSK_ENABLED)
		APP_PSK_TAG,
#endif
};

static int tls_init(void)
{
	int err = -EINVAL;

#if defined(MBEDTLS_X509_CRT_PARSE_C) || defined(CONFIG_NET_SOCKETS_OFFLOAD)
	err = tls_credential_add(APP_CA_CERT_TAG, TLS_CREDENTIAL_CA_CERTIFICATE,
				 ca_certificate, sizeof(ca_certificate));
	if (err < 0) {
		LOG_ERR("Failed to register public certificate: %d", err);
		return err;
	}
#endif

#if defined(MBEDTLS_KEY_EXCHANGE_SOME_PSK_ENABLED)
	err = tls_credential_add(APP_PSK_TAG, TLS_CREDENTIAL_PSK,
				 client_psk, sizeof(client_psk));
	if (err < 0) {
		LOG_ERR("Failed to register PSK: %d", err);
		return err;
	}

	err = tls_credential_add(APP_PSK_TAG, TLS_CREDENTIAL_PSK_ID,
				 client_psk_id, sizeof(client_psk_id) - 1);
	if (err < 0) {
		LOG_ERR("Failed to register PSK ID: %d", err);
	}
#endif

	return err;
}

#endif /* CONFIG_MQTT_LIB_TLS */

static void prepare_fds(struct mqtt_client *client)
{
	if (client->transport.type == MQTT_TRANSPORT_NON_SECURE) {
		fds[0].fd = client->transport.tcp.sock;
	}
#if defined(CONFIG_MQTT_LIB_TLS)
	else if (client->transport.type == MQTT_TRANSPORT_SECURE) {
		fds[0].fd = client->transport.tls.sock;
	}
#endif

	fds[0].events = ZSOCK_POLLIN;
	nfds = 1;
}

static void clear_fds(void)
{
	nfds = 0;
}

static int wait(int timeout)
{
	int ret = 0;

	if (nfds > 0) {
		ret = zsock_poll(fds, nfds, timeout);
		if (ret < 0) {
			LOG_ERR("poll error: %d", errno);
		}
	}

	return ret;
}

void mqtt_evt_handler(struct mqtt_client *const client,
		      const struct mqtt_evt *evt)
{
	int err;

	switch (evt->type) {
	case MQTT_EVT_CONNACK:
		if (evt->result != 0) {
			LOG_ERR("MQTT connect failed %d", evt->result);
			break;
		}

		connected = true;
		LOG_INF("MQTT client connected!");

		break;

	case MQTT_EVT_DISCONNECT:
		LOG_INF("MQTT client disconnected %d", evt->result);

		connected = false;
		clear_fds();

		break;

	case MQTT_EVT_PUBACK:
		if (evt->result != 0) {
			LOG_ERR("MQTT PUBACK error %d", evt->result);
			break;
		}

		LOG_INF("PUBACK packet id: %u", evt->param.puback.message_id);

		break;

	case MQTT_EVT_PUBREC:
		if (evt->result != 0) {
			LOG_ERR("MQTT PUBREC error %d", evt->result);
			break;
		}

		LOG_INF("PUBREC packet id: %u", evt->param.pubrec.message_id);

		const struct mqtt_pubrel_param rel_param = {
			.message_id = evt->param.pubrec.message_id
		};

		err = mqtt_publish_qos2_release(client, &rel_param);
		if (err != 0) {
			LOG_ERR("Failed to send MQTT PUBREL: %d", err);
		}

		break;

	case MQTT_EVT_PUBCOMP:
		if (evt->result != 0) {
			LOG_ERR("MQTT PUBCOMP error %d", evt->result);
			break;
		}

		LOG_INF("PUBCOMP packet id: %u",
			evt->param.pubcomp.message_id);

		break;

	case MQTT_EVT_PINGRESP:
		LOG_INF("PINGRESP packet");
		break;

	default:
		break;
	}
}

static char *get_mqtt_payload(enum mqtt_qos qos)
{
#if APP_BLUEMIX_TOPIC
	static APP_BMEM char payload[30];

	snprintk(payload, sizeof(payload), "{d:{temperature:%d}}",
		 (uint8_t)sys_rand32_get());
#else
	static APP_DMEM char payload[] = "DOORS:OPEN_QoSx";

	payload[strlen(payload) - 1] = '0' + qos;
#endif

	return payload;
}

static char *get_mqtt_topic(void)
{
#if APP_BLUEMIX_TOPIC
	return "iot-2/type/"BLUEMIX_DEVTYPE"/id/"BLUEMIX_DEVID
	       "/evt/"BLUEMIX_EVENT"/fmt/"BLUEMIX_FORMAT;
#else
	return "sensors";
#endif
}

static int publish(struct mqtt_client *client, enum mqtt_qos qos)
{
	struct mqtt_publish_param param;

	param.message.topic.qos = qos;
	param.message.topic.topic.utf8 = (uint8_t *)get_mqtt_topic();
	param.message.topic.topic.size =
			strlen(param.message.topic.topic.utf8);
	param.message.payload.data = get_mqtt_payload(qos);
	param.message.payload.len =
			strlen(param.message.payload.data);
	param.message_id = sys_rand32_get();
	param.dup_flag = 0U;
	param.retain_flag = 0U;

	return mqtt_publish(client, &param);
}

#define RC_STR(rc) ((rc) == 0 ? "OK" : "ERROR")

#define PRINT_RESULT(func, rc) \
	LOG_INF("%s: %d <%s>", (func), rc, RC_STR(rc))

static void broker_init(void)
{
#if defined(CONFIG_NET_IPV6)
	struct sockaddr_in6 *broker6 = (struct sockaddr_in6 *)&broker;

	broker6->sin6_family = AF_INET6;
	broker6->sin6_port = htons(SERVER_PORT);
	zsock_inet_pton(AF_INET6, SERVER_ADDR, &broker6->sin6_addr);

#if defined(CONFIG_SOCKS)
	struct sockaddr_in6 *proxy6 = (struct sockaddr_in6 *)&socks5_proxy;

	proxy6->sin6_family = AF_INET6;
	proxy6->sin6_port = htons(SOCKS5_PROXY_PORT);
	zsock_inet_pton(AF_INET6, SOCKS5_PROXY_ADDR, &proxy6->sin6_addr);
#endif
#else
	struct sockaddr_in *broker4 = (struct sockaddr_in *)&broker;

	broker4->sin_family = AF_INET;
	broker4->sin_port = htons(SERVER_PORT);
	zsock_inet_pton(AF_INET, SERVER_ADDR, &broker4->sin_addr);
#if defined(CONFIG_SOCKS)
	struct sockaddr_in *proxy4 = (struct sockaddr_in *)&socks5_proxy;

	proxy4->sin_family = AF_INET;
	proxy4->sin_port = htons(SOCKS5_PROXY_PORT);
	zsock_inet_pton(AF_INET, SOCKS5_PROXY_ADDR, &proxy4->sin_addr);
#endif
#endif
}

static void client_init(struct mqtt_client *client)
{
	mqtt_client_init(client);

	broker_init();

	/* MQTT client configuration */
	client->broker = &broker;
	client->evt_cb = mqtt_evt_handler;
	client->client_id.utf8 = (uint8_t *)MQTT_CLIENTID;
	client->client_id.size = strlen(MQTT_CLIENTID);
	client->password = NULL;
	client->user_name = NULL;
	client->protocol_version = MQTT_VERSION_3_1_1;

	/* MQTT buffers configuration */
	client->rx_buf = rx_buffer;
	client->rx_buf_size = sizeof(rx_buffer);
	client->tx_buf = tx_buffer;
	client->tx_buf_size = sizeof(tx_buffer);

	/* MQTT transport configuration */
#if defined(CONFIG_MQTT_LIB_TLS)
#if defined(CONFIG_MQTT_LIB_WEBSOCKET)
	client->transport.type = MQTT_TRANSPORT_SECURE_WEBSOCKET;
#else
	client->transport.type = MQTT_TRANSPORT_SECURE;
#endif

	struct mqtt_sec_config *tls_config = &client->transport.tls.config;

	tls_config->peer_verify = TLS_PEER_VERIFY_REQUIRED;
	tls_config->cipher_list = NULL;
	tls_config->sec_tag_list = m_sec_tags;
	tls_config->sec_tag_count = ARRAY_SIZE(m_sec_tags);
#if defined(MBEDTLS_X509_CRT_PARSE_C) || defined(CONFIG_NET_SOCKETS_OFFLOAD)
	tls_config->hostname = TLS_SNI_HOSTNAME;
#else
	tls_config->hostname = NULL;
#endif

#else
#if defined(CONFIG_MQTT_LIB_WEBSOCKET)
	client->transport.type = MQTT_TRANSPORT_NON_SECURE_WEBSOCKET;
#else
	client->transport.type = MQTT_TRANSPORT_NON_SECURE;
#endif
#endif

#if defined(CONFIG_MQTT_LIB_WEBSOCKET)
	client->transport.websocket.config.host = SERVER_ADDR;
	client->transport.websocket.config.url = "/mqtt";
	client->transport.websocket.config.tmp_buf = temp_ws_rx_buf;
	client->transport.websocket.config.tmp_buf_len =
						sizeof(temp_ws_rx_buf);
	client->transport.websocket.timeout = 5 * MSEC_PER_SEC;
#endif

#if defined(CONFIG_SOCKS)
	mqtt_client_set_proxy(client, &socks5_proxy,
			      socks5_proxy.sa_family == AF_INET ?
			      sizeof(struct sockaddr_in) :
			      sizeof(struct sockaddr_in6));
#endif
}

/* In this routine we block until the connected variable is 1 */
static int try_to_connect(struct mqtt_client *client)
{
	int rc, i = 0;

	while (i++ < APP_CONNECT_TRIES && !connected) {

		client_init(client);

		rc = mqtt_connect(client);
		if (rc != 0) {
			PRINT_RESULT("mqtt_connect", rc);
			k_sleep(K_MSEC(APP_SLEEP_MSECS));
			continue;
		}

		prepare_fds(client);

		if (wait(APP_CONNECT_TIMEOUT_MS)) {
			mqtt_input(client);
		}

		if (!connected) {
			mqtt_abort(client);
		}
	}

	if (connected) {
		return 0;
	}

	return -EINVAL;
}

static int process_mqtt_and_sleep(struct mqtt_client *client, int timeout)
{
	int64_t remaining = timeout;
	int64_t start_time = k_uptime_get();
	int rc;

	while (remaining > 0 && connected) {
		if (wait(remaining)) {
			rc = mqtt_input(client);
			if (rc != 0) {
				PRINT_RESULT("mqtt_input", rc);
				return rc;
			}
		}

		rc = mqtt_live(client);
		if (rc != 0 && rc != -EAGAIN) {
			PRINT_RESULT("mqtt_live", rc);
			return rc;
		} else if (rc == 0) {
			rc = mqtt_input(client);
			if (rc != 0) {
				PRINT_RESULT("mqtt_input", rc);
				return rc;
			}
		}

		remaining = timeout + start_time - k_uptime_get();
	}

	return 0;
}

#define SUCCESS_OR_EXIT(rc) { if (rc != 0) { return 1; } }
#define SUCCESS_OR_BREAK(rc) { if (rc != 0) { break; } }

static int publisher(void)
{
	int i, rc, r = 0;

	LOG_INF("attempting to connect: ");
	rc = try_to_connect(&client_ctx);
	PRINT_RESULT("try_to_connect", rc);
	SUCCESS_OR_EXIT(rc);

	i = 0;
	while (i++ < CONFIG_NET_SAMPLE_APP_MAX_ITERATIONS && connected) {
		r = -1;

		rc = mqtt_ping(&client_ctx);
		PRINT_RESULT("mqtt_ping", rc);
		SUCCESS_OR_BREAK(rc);

		rc = process_mqtt_and_sleep(&client_ctx, APP_SLEEP_MSECS);
		SUCCESS_OR_BREAK(rc);

		rc = publish(&client_ctx, MQTT_QOS_0_AT_MOST_ONCE);
		PRINT_RESULT("mqtt_publish", rc);
		SUCCESS_OR_BREAK(rc);

		rc = process_mqtt_and_sleep(&client_ctx, APP_SLEEP_MSECS);
		SUCCESS_OR_BREAK(rc);

		rc = publish(&client_ctx, MQTT_QOS_1_AT_LEAST_ONCE);
		PRINT_RESULT("mqtt_publish", rc);
		SUCCESS_OR_BREAK(rc);

		rc = process_mqtt_and_sleep(&client_ctx, APP_SLEEP_MSECS);
		SUCCESS_OR_BREAK(rc);

		rc = publish(&client_ctx, MQTT_QOS_2_EXACTLY_ONCE);
		PRINT_RESULT("mqtt_publish", rc);
		SUCCESS_OR_BREAK(rc);

		rc = process_mqtt_and_sleep(&client_ctx, APP_SLEEP_MSECS);
		SUCCESS_OR_BREAK(rc);

		r = 0;
	}

	rc = mqtt_disconnect(&client_ctx);
	PRINT_RESULT("mqtt_disconnect", rc);

	LOG_INF("Bye!");

	return r;
}

static int start_app(void)
{
	int r = 0, i = 0;

	while (!CONFIG_NET_SAMPLE_APP_MAX_CONNECTIONS ||
	       i++ < CONFIG_NET_SAMPLE_APP_MAX_CONNECTIONS) {
		r = publisher();

		if (!CONFIG_NET_SAMPLE_APP_MAX_CONNECTIONS) {
			k_sleep(K_MSEC(5000));
		}
	}

	return r;
}

#if defined(CONFIG_USERSPACE)
#define STACK_SIZE 2048

#if defined(CONFIG_NET_TC_THREAD_COOPERATIVE)
#define THREAD_PRIORITY K_PRIO_COOP(CONFIG_NUM_COOP_PRIORITIES - 1)
#else
#define THREAD_PRIORITY K_PRIO_PREEMPT(8)
#endif

K_THREAD_DEFINE(app_thread, STACK_SIZE,
		start_app, NULL, NULL, NULL,
		THREAD_PRIORITY, K_USER, -1);

static K_HEAP_DEFINE(app_mem_pool, 1024 * 2);
#endif

void main(void)
{
#if defined(CONFIG_MQTT_LIB_TLS)
	int rc;

	rc = tls_init();
	PRINT_RESULT("tls_init", rc);
#endif

#if defined(CONFIG_USERSPACE)
	int ret;

	struct k_mem_partition *parts[] = {
#if Z_LIBC_PARTITION_EXISTS
		&z_libc_partition,
#endif
		&app_partition
	};

	ret = k_mem_domain_init(&app_domain, ARRAY_SIZE(parts), parts);
	__ASSERT(ret == 0, "k_mem_domain_init() failed %d", ret);
	ARG_UNUSED(ret);

	k_mem_domain_add_thread(&app_domain, app_thread);
	k_thread_heap_assign(app_thread, &app_mem_pool);

	k_thread_start(app_thread);
	k_thread_join(app_thread, K_FOREVER);
#else
	exit(start_app());
#endif
}
```

## src/uart_poll.c
```c
#include "functions.h"

#define SOC_NODE DT_NODELABEL(sercom2)
#define name DT_PROP(DT_CHILD(SOC_NODE, sara_r4), label)



int init_module_sara(const struct device *uart_debug, const struct device *uart_modem_sara)
{
	
	if(!test_device(uart_modem_sara))    return -1;
	if(!test_device(uart_debug))         return -1;

	// module SARA-R4XX
	const struct gpio_dt_spec power_enable_sara = GPIO_DT_SPEC_GET(DT_CHILD(DT_NODELABEL(sercom2), sara_r4), mdm_power_gpios);
	const struct gpio_dt_spec reset_sara = GPIO_DT_SPEC_GET(DT_CHILD(DT_NODELABEL(sercom2), sara_r4), mdm_reset_gpios);


    int ret;

	// Activer broche x ET x
	ret = gpio_pin_configure(reset_sara.port, reset_sara.pin, GPIO_OUTPUT_ACTIVE);
	if (ret < 0) {
  		printk("Failed to configure SARA device binding.\n");
        return -1;
	}
	ret = gpio_pin_set(reset_sara.port, reset_sara.pin, false);
	if (ret < 0) {
  		printk("Failed to configure SARA device binding.\n");
        return -1;
	}

	ret = gpio_pin_configure(power_enable_sara.port, power_enable_sara.pin, GPIO_OUTPUT_ACTIVE);
	if (ret < 0) {
  		printk("Failed to configure SARA device binding.\n");
        return -1;
	}
	ret = gpio_pin_set(power_enable_sara.port, power_enable_sara.pin, true);
	if (ret < 0) {
  		printk("Failed to configure SARA device binding.\n");
        return -1;
	}
    	k_sleep(K_MSEC(150));
	
	ret = gpio_pin_set(power_enable_sara.port, power_enable_sara.pin, false);
	if (ret < 0) {
  		printk("Failed to configure SARA device binding.\n");
        return -1;
	}
	k_sleep(K_MSEC(500));



	// verifie configruration device
	printk("Name : %s\n", name);
	
	return 1;
}
    

int read_write_cellular_data(const struct device *uart_debug, const struct device *uart_modem_sara){
	console_getline_init();
	
	static uint8_t *poll_data;
	static const uint8_t *end = "\r\n";

	while (1) {
        	printk("-----------------------------------------------------------------------\n");
        	printk("Enter AT command : \n");

        	printk("command : ");
			poll_data = console_getline();

	        /*bool findCMD = false;
	        for(int i=0; i<sizeof(at_cmd_map); i++){
	            if(strcmp(poll_data, at_cmd_map[i]) == 0) findCMD=1;
	        }


	        if(findCMD){*/

	            strcat(poll_data, end);

	            if(test_poll_out(uart_modem_sara, poll_data))    printk("Commande envoyée.\n");
	            if(test_poll_in(uart_debug, uart_modem_sara))				printk("\nFin de la réponse.\n");
            
	        /*}
	        else{
			printk("Mauvaise commande ou commande non reconnu\n");
		}*/
	}
	return 1;
}


int test_poll_in(const struct device *uart_debug, const struct device *uart_modem_sara)
{
    uint8_t recv_char = 'N';
    uint8_t recv_char2 = 'N';

	//printk("Début réception : \n");
	// Verify uart_poll_in()
	while ((recv_char != 'K') || (recv_char2 != 'O')) {
        recv_char2 = recv_char;
		while (uart_poll_in(uart_modem_sara, &recv_char) < 0) {
			// Allow other thread/workqueue to work.
			k_yield();
		}
        uart_poll_out(uart_debug, recv_char);
	}
	//printk("\nFin réception.\n");
	return 1;
}


int test_poll_out(const struct device *uart_modem_sara, uint8_t *poll_data)
{
	int i;

	// Verify uart_poll_out()
	for (i = 0; i < strlen(poll_data); i++) {
		uart_poll_out(uart_modem_sara, poll_data[i]);
	}
	return 1;
}




// vérifie si le noeud récupéré n'est pas NULL et si il est prêt a être utilisé
int test_device(const struct device *uart_dev)
{

    if (!uart_dev) {
        printk("Cannot get UART device 1\n");
        return 0;
    }

    if(!device_is_ready(uart_dev)){
        printk("Device not ready\n");
        return 0;
    }
	return 1;
}
```
