## prj.conf
```kconfig
CONFIG_HEAP_MEM_POOL_SIZE=16384

CONFIG_STDOUT_CONSOLE=y
CONFIG_PRINTK=y

CONFIG_CONSOLE_SUBSYS=y
CONFIG_CONSOLE_GETLINE=y

CONFIG_GPIO=y

CONFIG_I2C=y

# Enable SPI
CONFIG_SPI=y

 
CONFIG_LOG=y
CONFIG_DISPLAY_LOG_LEVEL_ERR=y



CONFIG_CHARACTER_FRAMEBUFFER=y


#Enable display and LVGL
CONFIG_SSD16XX=y
CONFIG_DISPLAY=y
#CONFIG_LVGL=y




#CONFIG_MAIN_STACK_SIZE=2048

#CONFIG_LV_MEM_CUSTOM=y
#CONFIG_LV_USE_LOG=y
#CONFIG_LV_USE_LABEL=y
#CONFIG_LV_USE_BTN=y
#CONFIG_LV_USE_IMG=y
#CONFIG_LV_FONT_MONTSERRAT_14=y

 

#CONFIG_LV_Z_BITS_PER_PIXEL=1
#CONFIG_LV_Z_MEM_POOL_NUMBER_BLOCKS=8
#CONFIG_APP_LINK_WITH_LVGL=y


#CONFIG_LV_USE_THEME_DEFAULT=y
#CONFIG_LV_Z_VDB_SIZE=64
#CONFIG_LV_COLOR_DEPTH_1=y

 
```

## include/functions.h
```c
#ifndef FUNCTION_H
#define FUNCTION_H


#include <zephyr/kernel.h>
#include <zephyr/device.h>
#include <zephyr/devicetree.h>
#include <zephyr/drivers/gpio.h>
#include <zephyr/drivers/uart.h>
#include <zephyr/drivers/i2c.h>
#include <zephyr/drivers/spi.h>


#include <zephyr/sys/printk.h>
#include <zephyr/console/console.h>


#include <zephyr/drivers/display.h>
#include <zephyr/display/cfb.h>


#include <stdio.h>
#include <string.h>


// liste des commandes possibles pouvant êtres envoyées
static const uint8_t at_cmd_map[][15] = {
    "AT",
    "AT+CGMR",
    "AT+CGMI",
    "ATI"
};



// uart

// const struct uart_config uart_cfg = {
// 		.baudrate = 115200,
// 		.parity = UART_CFG_PARITY_NONE,
// 		.stop_bits = UART_CFG_STOP_BITS_1,
// 		.data_bits = UART_CFG_DATA_BITS_8,
// 		.flow_ctrl = UART_CFG_FLOW_CTRL_NONE
// };


void blink(void);


int test_device(const struct device *uart_dev);


int init_module_sara(const struct device *uart_debug, const struct device *uart_modem_sara);
int read_write_cellular_data(const struct device *uart_debug, const struct device *uart_modem_sara);

int test_poll_in(const struct device *uart_debug, const struct device *uart_modem_sara);
int test_poll_out(const struct device *uart_modem_sara, uint8_t *poll_data);

int init_module_eva(const struct device *i2c_dev);
void read_gps_data(const struct device *i2c_dev);
void config_gps(const struct device *i2c_dev);

int i2c_scanner(const struct device *i2c_dev);

void test_gpio(void);



/* The devicetree node identifier for the "led0" alias. */
#define RES DT_ALIAS(respin) //res
#define EPD_CS DT_ALIAS(cspin) //cs
#define EPD_DC DT_ALIAS(dcpin) //dc
#define EPD_BUSY DT_ALIAS(busypin) //busy
//#define LED0_NODE DT_ALIAS(led0)

static const struct gpio_dt_spec edp_res_pin  = GPIO_DT_SPEC_GET(RES, gpios);
static const struct gpio_dt_spec edp_cs_pin   = GPIO_DT_SPEC_GET(EPD_CS, gpios);
static const struct gpio_dt_spec edp_dc_pin   = GPIO_DT_SPEC_GET(EPD_DC, gpios);
static const struct gpio_dt_spec edp_busy_pin = GPIO_DT_SPEC_GET(EPD_BUSY, gpios);
//static const struct gpio_dt_spec led = GPIO_DT_SPEC_GET(LED0_NODE, gpios);

#define SPI_BUS DT_NODELABEL(spi1)

#define MONOMSB_MODE 1
#define MONOLSB_MODE 2 
#define RED_MODE     3

#define MAX_LINE_BYTES 25// =200/8
#define MAX_COLUMN_BYTES  200

#define ALLSCREEN_GRAGHBYTES	5000

///////////////////////////GPIO Settings//////////////////////////////////////////////////////

//#define EPD_W21_MOSI_0	GPIO_ResetBits(GPIOD, GPIO_Pin_10)
//#define EPD_W21_MOSI_1	GPIO_SetBits(GPIOD, GPIO_Pin_10)

//#define EPD_W21_CLK_0	GPIO_ResetBits(GPIOD, GPIO_Pin_9)
//#define EPD_W21_CLK_1	GPIO_SetBits(GPIOD, GPIO_Pin_9)

#define EPD_W21_CS_0	gpio_pin_set_dt(&edp_cs_pin, 0); //GPIO_ResetBits(GPIOD, GPIO_Pin_8)
#define EPD_W21_CS_1	gpio_pin_set_dt(&edp_cs_pin, 1); //GPIO_SetBits(GPIOD, GPIO_Pin_8)

#define EPD_W21_DC_0	gpio_pin_set_dt(&edp_dc_pin, 0); //GPIO_ResetBits(GPIOE, GPIO_Pin_15)
#define EPD_W21_DC_1	gpio_pin_set_dt(&edp_dc_pin, 1); //GPIO_SetBits(GPIOE, GPIO_Pin_15)

#define EPD_W21_RST_0	gpio_pin_set_dt(&edp_res_pin, 0); //GPIO_ResetBits(GPIOE, GPIO_Pin_14)
#define EPD_W21_RST_1	gpio_pin_set_dt(&edp_res_pin, 1); //GPIO_SetBits(GPIOE, GPIO_Pin_14)

#define EPD_W21_BUSY_LEVEL 0
#define isEPD_W21_BUSY gpio_pin_get_dt(&edp_busy_pin) //GPIO_ReadInputDataBit(GPIOE, GPIO_Pin_13) 


void driver_delay_xms(int32_t xms);			
void Epaper_READBUSY(void);
void Epaper_Spi_WriteByte(uint8_t TxData);
void Epaper_Write_Command(uint8_t cmd);
void Epaper_Write_Data(uint8_t data);

void EPD_HW_Init(void); //Electronic paper initialization
void EPD_Update(void);

void EPD_Part_Init(void);//Local refresh initialization
void EPD_Part_Update(void); 

void EPD_WhiteScreen_White(void);
void EPD_DeepSleep(void);
//Display 
void EPD_WhiteScreen_ALL(const unsigned char *datas);
void EPD_SetRAMValue_BaseMap(const unsigned char * datas);
void EPD_Dis_Part(unsigned int x_start,unsigned int y_start,const unsigned char * datas,unsigned int PART_COLUMN,unsigned int PART_LINE);
void EPD_Dis_Part_myself(unsigned int x_startA,unsigned int y_startA,const unsigned char * datasA,
	                       unsigned int x_startB,unsigned int y_startB,const unsigned char * datasB,
												 unsigned int x_startC,unsigned int y_startC,const unsigned char * datasC,
												 unsigned int x_startD,unsigned int y_startD,const unsigned char * datasD,
											   unsigned int x_startE,unsigned int y_startE,const unsigned char * datasE,
												 unsigned int PART_COLUMN,unsigned int PART_LINE
);


#endif
```

## src/epaper.c
```c
#include "functions.h"

const struct device* spi_dev = DEVICE_DT_GET(DT_NODELABEL(sercom5));

const struct spi_config spi_cfg = {
  .frequency = 4000000U,
  .operation = SPI_WORD_SET(8) | SPI_TRANSFER_MSB | SPI_OP_MODE_MASTER
};

void driver_delay_xms(int32_t xms)	
{	
    /* unsigned long i = 0 , j=0;

    for(j=0;j<xms;j++)
	{
        for(i=0; i<256*40; i++);
    } */
	k_msleep(xms);
}


void Epaper_Spi_WriteByte(uint8_t TxData)
{				   			 
	/* unsigned char TempData;
	unsigned char scnt;
	TempData=TxData;

  EPD_W21_CLK_0;  
	for(scnt=0;scnt<8;scnt++)
	{ 
		if(TempData&0x80)
		  EPD_W21_MOSI_1 ;
		else
		  EPD_W21_MOSI_0 ;
		EPD_W21_CLK_1;  
	  EPD_W21_CLK_0;  
		TempData=TempData<<1;

  } */
	struct spi_buf bufs[] = {
		{
			.buf = &TxData,
			.len = 1
		},
	};

	struct spi_buf_set tx = {
		.buffers = bufs,
		.count = 1
	};

	spi_write(spi_dev, &spi_cfg, &tx);
}

void Epaper_READBUSY(void)
{ 
  while(1)
  {	 //=1 BUSY
     if(isEPD_W21_BUSY==0) break;;
  }  
}

void Epaper_Write_Command(uint8_t cmd)
{
	EPD_W21_CS_1;
	EPD_W21_CS_0;
	EPD_W21_DC_0;  // D/C#   0:command  1:data

	Epaper_Spi_WriteByte(cmd);
	EPD_W21_CS_1;
}

void Epaper_Write_Data(uint8_t data)
{
	EPD_W21_CS_1;
	EPD_W21_CS_0;
	EPD_W21_DC_1;  // D/C#   0:command  1:data

	Epaper_Spi_WriteByte(data);
	EPD_W21_CS_1;
}


	
/////////////////////////////////////////////////////////////////////
//////////////////////////////////////////////////////////////////////////////////////////////////

void EPD_HW_Init(void)
{
	EPD_W21_RST_0;  // Module reset   
	driver_delay_xms(100);//At least 10ms delay 
	EPD_W21_RST_1;
	driver_delay_xms(100); //At least 10ms delay 
	
	Epaper_READBUSY();   
	Epaper_Write_Command(0x12);  //SWRESET
	Epaper_READBUSY();   
		
	Epaper_Write_Command(0x01); //Driver output control      
	Epaper_Write_Data(0xC7);
	Epaper_Write_Data(0x00);
	Epaper_Write_Data(0x00);

	Epaper_Write_Command(0x11); //data entry mode       
	Epaper_Write_Data(0x01);

	Epaper_Write_Command(0x44); //set Ram-X address start/end position   
	Epaper_Write_Data(0x00);
	Epaper_Write_Data(0x18);    //0x0C-->(18+1)*8=200

	Epaper_Write_Command(0x45); //set Ram-Y address start/end position          
	Epaper_Write_Data(0xC7);    //0xC7-->(199+1)=200
	Epaper_Write_Data(0x00);
	Epaper_Write_Data(0x00);
	Epaper_Write_Data(0x00); 

	Epaper_Write_Command(0x3C); //BorderWavefrom
	Epaper_Write_Data(0x05);	
	  	
  Epaper_Write_Command(0x18); //Read built-in temperature sensor
	Epaper_Write_Data(0x80);	

	Epaper_Write_Command(0x4E);   // set RAM x address count to 0;
	Epaper_Write_Data(0x00);
	Epaper_Write_Command(0x4F);   // set RAM y address count to 0X199;    
	Epaper_Write_Data(0xC7);
	Epaper_Write_Data(0x00);
  Epaper_READBUSY();
	
}
/////////////////////////////////////////////////////////////////////////////////////////
/*When the electronic paper screen is updated, do not unplug the electronic paper to avoid damage to the screen*/

void EPD_Update(void)
{   
  Epaper_Write_Command(0x22); //Display Update Control
  Epaper_Write_Data(0xF7);   
  Epaper_Write_Command(0x20); //Activate Display Update Sequence
  Epaper_READBUSY();   

}
/*When the electronic paper screen is updated, do not unplug the electronic paper to avoid damage to the screen*/
void EPD_Part_Update(void)
{
	Epaper_Write_Command(0x22); //Display Update Control
	Epaper_Write_Data(0xFF);   
	Epaper_Write_Command(0x20); //Activate Display Update Sequence
	Epaper_READBUSY(); 			
}
//////////////////////////////All screen update////////////////////////////////////////////
void EPD_WhiteScreen_ALL(const unsigned char *datas)
{
   unsigned int i;	
  Epaper_Write_Command(0x24);   //write RAM for black(0)/white (1)
   for(i=0;i<ALLSCREEN_GRAGHBYTES;i++)
   {               
     Epaper_Write_Data(*datas);
			datas++;
   }
   EPD_Update();	 
}
///////////////////////////Part update//////////////////////////////////////////////
//The x axis is reduced by one byte, and the y axis is reduced by one pixel.
void EPD_SetRAMValue_BaseMap( const unsigned char * datas)
{
	unsigned int i;   
	const unsigned char  *datas_flag;   
	datas_flag=datas;

	
  Epaper_Write_Command(0x24);   //Write Black and White image to RAM
   for(i=0;i<ALLSCREEN_GRAGHBYTES;i++)
   {               
     Epaper_Write_Data(*datas);
			datas++;
   }
	 datas=datas_flag;
  Epaper_Write_Command(0x26);   //Write Black and White image to RAM
   for(i=0;i<ALLSCREEN_GRAGHBYTES;i++)
   {               
     Epaper_Write_Data(*datas);
			datas++;
   }
   EPD_Update();		 
	 
}
void EPD_Dis_Part(unsigned int x_start,unsigned int y_start,const unsigned char * datas,unsigned int PART_COLUMN,unsigned int PART_LINE)
{
	unsigned int i;  
	unsigned int x_end,y_start1,y_start2,y_end1,y_end2;
	x_start=x_start/8;
	x_end=x_start+PART_LINE/8-1; 
	
	y_start1=0;
	y_start2=y_start;
	if(y_start>=256)
	{
		y_start1=y_start2/256;
		y_start2=y_start2%256;
	}
	y_end1=0;
	y_end2=y_start+PART_COLUMN-1;
	if(y_end2>=256)
	{
		y_end1=y_end2/256;
		y_end2=y_end2%256;		
	}		
	
	Epaper_Write_Command(0x44);       // set RAM x address start/end, in page 35
	Epaper_Write_Data(x_start);    // RAM x address start at 00h;
	Epaper_Write_Data(x_end);    // RAM x address end at 0fh(15+1)*8->128 
	Epaper_Write_Command(0x45);       // set RAM y address start/end, in page 35
	Epaper_Write_Data(y_start2);    // RAM y address start at 0127h;
	Epaper_Write_Data(y_start1);    // RAM y address start at 0127h;
	Epaper_Write_Data(y_end2);    // RAM y address end at 00h;
	Epaper_Write_Data(y_end1);    // ????=0	


	Epaper_Write_Command(0x4E);   // set RAM x address count to 0;
	Epaper_Write_Data(x_start); 
	Epaper_Write_Command(0x4F);   // set RAM y address count to 0X127;    
	Epaper_Write_Data(y_start2);
	Epaper_Write_Data(y_start1);
	
	
	 Epaper_Write_Command(0x24);   //Write Black and White image to RAM
   for(i=0;i<PART_COLUMN*PART_LINE/8;i++)
   {                         
     Epaper_Write_Data(*datas);
			datas++;
   } 
	 EPD_Part_Update();

}

void EPD_DeepSleep(void)
{  	
  Epaper_Write_Command(0x10); //enter deep sleep
  Epaper_Write_Data(0x01); 
  driver_delay_xms(100);
}


/////////////////////////////////Single display////////////////////////////////////////////////

void EPD_WhiteScreen_White(void)

{
   unsigned int i,k;
	 Epaper_Write_Command(0x24);   //write RAM for black(0)/white (1)
	for(k=0;k<250;k++)
  {
		for(i=0;i<25;i++)
		{
			Epaper_Write_Data(0xff);
			}
  }
	EPD_Update();
}

/////////////////////////////////////TIME///////////////////////////////////////////////////
void EPD_Dis_Part_myself(unsigned int x_startA,unsigned int y_startA,const unsigned char * datasA,
	                       unsigned int x_startB,unsigned int y_startB,const unsigned char * datasB,
												 unsigned int x_startC,unsigned int y_startC,const unsigned char * datasC,
												 unsigned int x_startD,unsigned int y_startD,const unsigned char * datasD,
											   unsigned int x_startE,unsigned int y_startE,const unsigned char * datasE,
												 unsigned int PART_COLUMN,unsigned int PART_LINE
	                      )
{
	unsigned int i;  
	unsigned int x_end,y_start1,y_start2,y_end1,y_end2;
	
	//Data A////////////////////////////
	x_startA=x_startA/8;//Convert to byte
	x_end=x_startA+PART_LINE/8-1; 
	
	y_start1=0;
	y_start2=y_startA-1;
	if(y_startA>=256)
	{
		y_start1=y_start2/256;
		y_start2=y_start2%256;
	}
	y_end1=0;
	y_end2=y_startA+PART_COLUMN-1;
	if(y_end2>=256)
	{
		y_end1=y_end2/256;
		y_end2=y_end2%256;		
	}		
	
	Epaper_Write_Command(0x44);       // set RAM x address start/end, in page 35
	Epaper_Write_Data(x_startA);    // RAM x address start at 00h;
	Epaper_Write_Data(x_end);    // RAM x address end at 0fh(15+1)*8->128 
	Epaper_Write_Command(0x45);       // set RAM y address start/end, in page 35
	Epaper_Write_Data(y_start2);    // RAM y address start at 0127h;
	Epaper_Write_Data(y_start1);    // RAM y address start at 0127h;
	Epaper_Write_Data(y_end2);    // RAM y address end at 00h;
	Epaper_Write_Data(y_end1);    


	Epaper_Write_Command(0x4E);   // set RAM x address count to 0;
	Epaper_Write_Data(x_startA); 
	Epaper_Write_Command(0x4F);   // set RAM y address count to 0X127;    
	Epaper_Write_Data(y_start2);
	Epaper_Write_Data(y_start1);
	
	
	 Epaper_Write_Command(0x24);   //Write Black and White image to RAM
   for(i=0;i<PART_COLUMN*PART_LINE/8;i++)
   {                         
     Epaper_Write_Data(*datasA);
			datasA++;
   } 
	//Data B/////////////////////////////////////
	x_startB=x_startB/8;//Convert to byte
	x_end=x_startB+PART_LINE/8-1; 
	
	y_start1=0;
	y_start2=y_startB-1;
	if(y_startB>=256)
	{
		y_start1=y_start2/256;
		y_start2=y_start2%256;
	}
	y_end1=0;
	y_end2=y_startB+PART_COLUMN-1;
	if(y_end2>=256)
	{
		y_end1=y_end2/256;
		y_end2=y_end2%256;		
	}		
	
	Epaper_Write_Command(0x44);       // set RAM x address start/end, in page 35
	Epaper_Write_Data(x_startB);    // RAM x address start at 00h;
	Epaper_Write_Data(x_end);    // RAM x address end at 0fh(15+1)*8->128 
	Epaper_Write_Command(0x45);       // set RAM y address start/end, in page 35
	Epaper_Write_Data(y_start2);    // RAM y address start at 0127h;
	Epaper_Write_Data(y_start1);    // RAM y address start at 0127h;
	Epaper_Write_Data(y_end2);    // RAM y address end at 00h;
	Epaper_Write_Data(y_end1);   


	Epaper_Write_Command(0x4E);   // set RAM x address count to 0;
	Epaper_Write_Data(x_startB); 
	Epaper_Write_Command(0x4F);   // set RAM y address count to 0X127;    
	Epaper_Write_Data(y_start2);
	Epaper_Write_Data(y_start1);
	
	
	 Epaper_Write_Command(0x24);   //Write Black and White image to RAM
   for(i=0;i<PART_COLUMN*PART_LINE/8;i++)
   {                         
     Epaper_Write_Data(*datasB);
			datasB++;
   } 	 
	 
	//Data C//////////////////////////////////////
	x_startC=x_startC/8;//Convert to byte
	x_end=x_startC+PART_LINE/8-1; 
	
	y_start1=0;
	y_start2=y_startC-1;
	if(y_startC>=256)
	{
		y_start1=y_start2/256;
		y_start2=y_start2%256;
	}
	y_end1=0;
	y_end2=y_startC+PART_COLUMN-1;
	if(y_end2>=256)
	{
		y_end1=y_end2/256;
		y_end2=y_end2%256;		
	}		
	
	Epaper_Write_Command(0x44);       // set RAM x address start/end, in page 35
	Epaper_Write_Data(x_startC);    // RAM x address start at 00h;
	Epaper_Write_Data(x_end);    // RAM x address end at 0fh(15+1)*8->128 
	Epaper_Write_Command(0x45);       // set RAM y address start/end, in page 35
	Epaper_Write_Data(y_start2);    // RAM y address start at 0127h;
	Epaper_Write_Data(y_start1);    // RAM y address start at 0127h;
	Epaper_Write_Data(y_end2);    // RAM y address end at 00h;
	Epaper_Write_Data(y_end1);   


	Epaper_Write_Command(0x4E);   // set RAM x address count to 0;
	Epaper_Write_Data(x_startC); 
	Epaper_Write_Command(0x4F);   // set RAM y address count to 0X127;    
	Epaper_Write_Data(y_start2);
	Epaper_Write_Data(y_start1);
	
	
	 Epaper_Write_Command(0x24);   //Write Black and White image to RAM
   for(i=0;i<PART_COLUMN*PART_LINE/8;i++)
   {                         
     Epaper_Write_Data(*datasC);
			datasC++;
   } 	 	 
 	 
	//Data D//////////////////////////////////////
	x_startD=x_startD/8;//Convert to byte
	x_end=x_startD+PART_LINE/8-1; 
	
	y_start1=0;
	y_start2=y_startD-1;
	if(y_startD>=256)
	{
		y_start1=y_start2/256;
		y_start2=y_start2%256;
	}
	y_end1=0;
	y_end2=y_startD+PART_COLUMN-1;
	if(y_end2>=256)
	{
		y_end1=y_end2/256;
		y_end2=y_end2%256;		
	}		
	
	Epaper_Write_Command(0x44);       // set RAM x address start/end, in page 35
	Epaper_Write_Data(x_startD);    // RAM x address start at 00h;
	Epaper_Write_Data(x_end);        // RAM x address end at 0fh(15+1)*8->128 
	Epaper_Write_Command(0x45);       // set RAM y address start/end, in page 35
	Epaper_Write_Data(y_start2);    // RAM y address start at 0127h;
	Epaper_Write_Data(y_start1);    // RAM y address start at 0127h;
	Epaper_Write_Data(y_end2);    // RAM y address end at 00h;
	Epaper_Write_Data(y_end1);    


	Epaper_Write_Command(0x4E);   // set RAM x address count to 0;
	Epaper_Write_Data(x_startD); 
	Epaper_Write_Command(0x4F);   // set RAM y address count to 0X127;    
	Epaper_Write_Data(y_start2);
	Epaper_Write_Data(y_start1);
	
	
	 Epaper_Write_Command(0x24);   //Write Black and White image to RAM
   for(i=0;i<PART_COLUMN*PART_LINE/8;i++)
   {                         
     Epaper_Write_Data(*datasD);
			datasD++;
   } 
	//Data E//////////////////////////////////////
	x_startE=x_startE/8;//Convert to byte
	x_end=x_startE+PART_LINE/8-1; 
	
	y_start1=0;
	y_start2=y_startE-1;
	if(y_startE>=256)
	{
		y_start1=y_start2/256;
		y_start2=y_start2%256;
	}
	y_end1=0;
	y_end2=y_startE+PART_COLUMN-1;
	if(y_end2>=256)
	{
		y_end1=y_end2/256;
		y_end2=y_end2%256;		
	}		
	
	Epaper_Write_Command(0x44);       // set RAM x address start/end, in page 35
	Epaper_Write_Data(x_startE);    // RAM x address start at 00h;
	Epaper_Write_Data(x_end);    // RAM x address end at 0fh(15+1)*8->128 
	Epaper_Write_Command(0x45);       // set RAM y address start/end, in page 35
	Epaper_Write_Data(y_start2);    // RAM y address start at 0127h;
	Epaper_Write_Data(y_start1);    // RAM y address start at 0127h;
	Epaper_Write_Data(y_end2);    // RAM y address end at 00h;
	Epaper_Write_Data(y_end1);    


	Epaper_Write_Command(0x4E);   // set RAM x address count to 0;
	Epaper_Write_Data(x_startE); 
	Epaper_Write_Command(0x4F);   // set RAM y address count to 0X127;    
	Epaper_Write_Data(y_start2);
	Epaper_Write_Data(y_start1);
	
	
	 Epaper_Write_Command(0x24);   //Write Black and White image to RAM
   for(i=0;i<PART_COLUMN*PART_LINE/8;i++)
   {                         
     Epaper_Write_Data(*datasE);
			datasE++;
   } 	  
	 EPD_Part_Update();

}


//////////////////////////////////////////////////////////////////////////////////////
```

## src/uart_poll.c
```c
#include "functions.h"

#define SOC_NODE DT_NODELABEL(sercom2)
#define name DT_PROP(DT_CHILD(SOC_NODE, sara_r4), label)



int init_module_sara(const struct device *uart_debug, const struct device *uart_modem_sara)
{
	
	if(!test_device(uart_modem_sara))    return -1;
	if(!test_device(uart_debug))         return -1;

	// module SARA-R4XX
	const struct gpio_dt_spec power_enable_sara = GPIO_DT_SPEC_GET(DT_CHILD(DT_NODELABEL(sercom2), sara_r4), mdm_power_gpios);
	const struct gpio_dt_spec reset_sara = GPIO_DT_SPEC_GET(DT_CHILD(DT_NODELABEL(sercom2), sara_r4), mdm_reset_gpios);


    int ret;

	// Activer broche x ET x
	ret = gpio_pin_configure(reset_sara.port, reset_sara.pin, GPIO_OUTPUT_ACTIVE);
	if (ret < 0) {
  		printk("Failed to configure SARA device binding.\n");
        return -1;
	}
	ret = gpio_pin_set(reset_sara.port, reset_sara.pin, false);
	if (ret < 0) {
  		printk("Failed to configure SARA device binding.\n");
        return -1;
	}

	ret = gpio_pin_configure(power_enable_sara.port, power_enable_sara.pin, GPIO_OUTPUT_ACTIVE);
	if (ret < 0) {
  		printk("Failed to configure SARA device binding.\n");
        return -1;
	}
	ret = gpio_pin_set(power_enable_sara.port, power_enable_sara.pin, true);
	if (ret < 0) {
  		printk("Failed to configure SARA device binding.\n");
        return -1;
	}
    	k_sleep(K_MSEC(150));
	
	ret = gpio_pin_set(power_enable_sara.port, power_enable_sara.pin, false);
	if (ret < 0) {
  		printk("Failed to configure SARA device binding.\n");
        return -1;
	}
	k_sleep(K_MSEC(500));



	// verifie configruration device
	printk("Name : %s\n", name);
	
	return 1;
}
    

int read_write_cellular_data(const struct device *uart_debug, const struct device *uart_modem_sara){
	console_getline_init();
	
	static uint8_t *poll_data;
	static const uint8_t *end = "\r\n";

	while (1) {
        	printk("-----------------------------------------------------------------------\n");
        	printk("Enter AT command : \n");

        	printk("command : ");
			poll_data = console_getline();

	        bool findCMD = false;
	        for(int i=0; i<sizeof(at_cmd_map); i++){
	            if(strcmp(poll_data, at_cmd_map[i]) == 0) findCMD=1;
	        }


	        if(findCMD){

	            strcat(poll_data, end);

	            if(test_poll_out(uart_modem_sara, poll_data))    printk("Commande envoyée.\n");
	            if(test_poll_in(uart_debug, uart_modem_sara))				printk("\nFin de la réponse.\n");
            
	        }
	        else{
			printk("Mauvaise commande ou commande non reconnu\n");
		}
	}
	return 1;
}


int test_poll_in(const struct device *uart_debug, const struct device *uart_modem_sara)
{
    uint8_t recv_char = 'N';
    uint8_t recv_char2 = 'N';

	//printk("Début réception : \n");
	// Verify uart_poll_in()
	while ((recv_char != 'K') && (recv_char2 != 'O')) {
        recv_char2 = recv_char;
		while (uart_poll_in(uart_modem_sara, &recv_char) < 0) {
			// Allow other thread/workqueue to work.
			k_yield();
		}
        uart_poll_out(uart_debug, recv_char);
	}
	//printk("\nFin réception.\n");
	return 1;
}


int test_poll_out(const struct device *uart_modem_sara, uint8_t *poll_data)
{
	int i;

	// Verify uart_poll_out()
	for (i = 0; i < strlen(poll_data); i++) {
		uart_poll_out(uart_modem_sara, poll_data[i]);
	}
	return 1;
}




// vérifie si le noeud récupéré n'est pas NULL et si il est prêt a être utilisé
int test_device(const struct device *uart_dev)
{

    if (!uart_dev) {
        printk("Cannot get UART device 1\n");
        return 0;
    }

    if(!device_is_ready(uart_dev)){
        printk("Device not ready\n");
        return 0;
    }
	return 1;
}
```
