## CMakeLists.txt
```
# SPDX-License-Identifier: Apache-2.0

cmake_minimum_required(VERSION 3.20.0)
find_package(Zephyr REQUIRED HINTS $ENV{ZEPHYR_BASE})
project(blinky)

include_directories(include)

FILE(GLOB app_sources src/*.c)
target_sources(app PRIVATE ${app_sources})

# Ajouter un fichier d'en-tête (.h) à la cible "app"
target_sources(app PRIVATE include/functions.h)
```

## prj.conf
```kconfig
CONFIG_STDOUT_CONSOLE=y
CONFIG_PRINTK=y

CONFIG_CONSOLE_SUBSYS=y
CONFIG_CONSOLE_GETLINE=y

CONFIG_GPIO=y

CONFIG_I2C=y
```

## src/main.c
```c
#include "functions.h"



//i2c
const struct device *i2c_dev = DEVICE_DT_GET(DT_NODELABEL(sercom3));

void main(void)
{

	//blink();
	
	//init_module_sara();
	
	i2c_scanner(i2c_dev);
	
	init_module_eva(i2c_dev);
	
	read_gps_data(i2c_dev);
}
```

## include/functions.h
```c
#ifndef FUNCTION_H
#define FUNCTION_H


#include <zephyr/kernel.h>
#include <zephyr/device.h>
#include <zephyr/devicetree.h>
#include <zephyr/drivers/gpio.h>
#include <zephyr/drivers/uart.h>
#include <zephyr/drivers/i2c.h>


#include <zephyr/sys/printk.h>
#include <zephyr/console/console.h>


#include <stdio.h>
#include <string.h>


// liste des commandes possibles pouvant êtres envoyées
static const uint8_t at_cmd_map[][15] = {
    "AT",
    "AT+CGMR",
    "AT+CGMI",
    "ATI"
};



// uart

// const struct uart_config uart_cfg = {
// 		.baudrate = 115200,
// 		.parity = UART_CFG_PARITY_NONE,
// 		.stop_bits = UART_CFG_STOP_BITS_1,
// 		.data_bits = UART_CFG_DATA_BITS_8,
// 		.flow_ctrl = UART_CFG_FLOW_CTRL_NONE
// };


void blink(void);


int test_device(const struct device *uart_dev);


int init_module_sara(void);
int test_poll_in(void);
int test_poll_out(uint8_t *poll_data);

int init_module_eva(const struct device *i2c_dev);
void read_gps_data(const struct device *i2c_dev);
void config_gps(const struct device *i2c_dev);

int i2c_scanner(const struct device *i2c_dev);

void test_gpio(void);

#endif
```

## src/i2c_gps.c
```c
#include "functions.h"

#define SOC_NODE DT_NODELABEL(sercom3)
#define GPS_ADR DT_REG_ADDR(DT_CHILD(SOC_NODE, eva8m_42))
#define I2C_SPEED DT_PROP(SOC_NODE, clock_frequency)


int init_module_eva(const struct device *i2c_dev)
{
    int ret;    

    // module EVA-8M
    const struct gpio_dt_spec power_enable_eva = GPIO_DT_SPEC_GET(DT_CHILD(DT_NODELABEL(sercom3), eva8m_42), gps_power_gpios);

    
    if(!test_device(i2c_dev)) return -1;

    gpio_pin_configure(power_enable_eva.port, power_enable_eva.pin, GPIO_OUTPUT_ACTIVE);
    k_sleep(K_MSEC(500));

    
    //I2C_SPEED_FAST
    ret = i2c_configure(i2c_dev, I2C_SPEED_SET(I2C_SPEED) | I2C_MODE_MASTER);
    if (ret < 0) {
        printk("Error configuring I2C: %d\n", ret);
        return -1;
    }

    k_sleep(K_MSEC(2000));
    return 1;
}


void config_gps(const struct device *i2c_dev){

    int ret;
    const uint8_t ubx_without_checksum[] = {0xB5, 0x62, 0x06, 0x01, 0x08, 0x00, 0xF0, 0x04,
                                            0x00, 0x00, 0x00, 0x00, 0x00, 0x01, 0x01, 0x2B};
    uint8_t ck_a = 0, ck_b = 0;

    for(int i=2; i<sizeof(ubx_without_checksum)-2; i++)
    {   ck_a = ck_a + ubx_without_checksum[i];
        ck_b = ck_b + ck_a;
    }

    printk("ck_a : %d\n", ck_a);
    printk("ck_b : %d\n", ck_b);


    const uint8_t ubx[] = {0xB5, 0x62, 0x06, 0x01, 0x08, 0x00, 0xF0, 0x04,
                            0x00, 0x00, 0x00, 0x00, 0x00, 0x01, ck_a, ck_b};
    

    // HEADER       : SYNC_CHAR1 : 0xB5 & SYNC_CHAR2 : 0x62
    // CLASS        : 0x06
    // ID           : 0x01
    // LENGTH       : 0x08 & 0x00
    // PAYLOAD      : (0xF0, 0x01) for GLL
    // CHECKSUM     : CK_A : 0x01 & CK_B : 0x2B


    ret = i2c_write(i2c_dev, ubx, sizeof(ubx), GPS_ADR);
    if (ret < 0) {
        printk("Error writing GPS: %d\n", ret);
    } else {
        printk("Success writing GPS\n");
    }
}


// lire en boucle les trames de données du gps et les afficher
void read_gps_data(const struct device *i2c_dev){

    int ret;
    uint8_t addr_ = 0xFD;

    ret = i2c_write(i2c_dev, &addr_, 1, GPS_ADR);
    if (ret != 0) {
        printk("Error writing to GPS: %d\n", ret);
        return;
    }

    uint8_t buf_size;
    ret = i2c_read(i2c_dev, &buf_size, 1, 0x42);
    if (ret < 0) {
        printk("Error reading GPS buffer size: %d\n", ret);
    }

    
    uint8_t buf[buf_size];

    memset(buf, 0, buf_size);

    k_sleep(K_MSEC(1000));


    while (1) {

        for(int i=0; i<buf_size; i++){

            ret = i2c_read(i2c_dev, &buf[i], 1, GPS_ADR);

            if (ret < 0) {
                printk("Error reading GPS: %d\n", ret);
            } else {
                
                printk("%c", buf[i]);
            }
        
        }
        k_sleep(K_MSEC(1000));
    }
}
```

## src/i2c_scanner.c
```c
#include "functions.h"

#define I2C_ADDR_MIN 0x08 // Adresse minimale à scanner
#define I2C_ADDR_MAX 0x77 // Adresse maximale à scanner


int i2c_scanner(const struct device *i2c_dev)
{

    if(!test_device(i2c_dev)) return -1;
    if(!init_module_eva(i2c_dev)) return -1;
    
    int ret;
    struct i2c_msg msg;
    uint8_t dummy_byte = 0;
    int i2c_addr;

    printf("Scanning des adresses I2C...\n");

    for (i2c_addr = I2C_ADDR_MIN; i2c_addr <= I2C_ADDR_MAX; i2c_addr++) {
        msg.flags = I2C_MSG_WRITE | I2C_MSG_STOP;
        msg.len = 1;
        msg.buf = &dummy_byte;

        ret = i2c_transfer(i2c_dev, &msg, 1, i2c_addr);
        if (ret == 0) {
            printf("Adresse I2C détectée: 0x%x\n", i2c_addr);
        }
		//printf("ret: %d\n", ret);
    }

    printf("Terminé.\n");
    return 1;
}
```

## src/led.c
```c
/*#include <zephyr/kernel.h>
#include <zephyr/device.h>
#include <zephyr/devicetree.h>
#include <zephyr/drivers/gpio.h>
#include <zephyr/drivers/uart.h>
#include <zephyr/drivers/i2c.h>


#include <zephyr/sys/printk.h>
#include <zephyr/console/console.h>*/

#include "functions.h"

// 1000 msec = 1 sec
#define SLEEP_TIME_MS 800

// The devicetree node identifier for the "led0" alias.
#define LED0_NODE DT_ALIAS(led0)
#define LED1_NODE DT_ALIAS(led1)
#define LED2_NODE DT_ALIAS(led2)


static const struct gpio_dt_spec led0 = GPIO_DT_SPEC_GET(LED0_NODE, gpios);
static const struct gpio_dt_spec led1 = GPIO_DT_SPEC_GET(LED1_NODE, gpios);
static const struct gpio_dt_spec led2 = GPIO_DT_SPEC_GET(LED2_NODE, gpios);


void blink(void)
{
	int ret;

	if (!gpio_is_ready_dt(&led0)) {
		return;
	}
	if (!gpio_is_ready_dt(&led1)) {
		return;
	}
	if (!gpio_is_ready_dt(&led2)) {
		return;
	}

	ret = gpio_pin_configure_dt(&led0, GPIO_OUTPUT_ACTIVE);
	if (ret < 0) {
		return;
	}
	ret = gpio_pin_configure_dt(&led1, GPIO_OUTPUT_ACTIVE);
	if (ret < 0) {
		return;
	}
	ret = gpio_pin_configure_dt(&led2, GPIO_OUTPUT_ACTIVE);
	if (ret < 0) {
		return;
	}

	
	while (1) {
		ret = gpio_pin_toggle_dt(&led0);
		if (ret < 0) {
			return;
		}
		k_msleep(SLEEP_TIME_MS);
		
		/*ret = gpio_pin_toggle_dt(&led1);
		if (ret < 0) {
			return;
		}
		k_msleep(SLEEP_TIME_MS);*/
		
		ret = gpio_pin_toggle_dt(&led2);
		if (ret < 0) {
			return;
		}
		k_msleep(SLEEP_TIME_MS);
	}
}
```

## src/uart_poll.c
```c
#include "functions.h"

#define SOC_NODE DT_NODELABEL(sercom2)
#define name DT_PROP(DT_CHILD(SOC_NODE, sara_r4), label)

//uart
const struct device *uart_debug = DEVICE_DT_GET(DT_NODELABEL(sercom5));
const struct device *uart_modem_sara = DEVICE_DT_GET(DT_NODELABEL(sercom2));


int init_module_sara(void)
{
	// module SARA-R4XX
	const struct gpio_dt_spec power_enable_sara = GPIO_DT_SPEC_GET(DT_CHILD(DT_NODELABEL(sercom2), sara_r4), mdm_power_gpios);
	const struct gpio_dt_spec change_voltage_sara = GPIO_DT_SPEC_GET(DT_CHILD(DT_NODELABEL(sercom2), sara_r4), mdm_vint_gpios);

    static uint8_t *poll_data;
    static const uint8_t *end = "\r\n";

    int ret;

	// Activer broche 4 ET 10
	ret = gpio_pin_configure(power_enable_sara.port, power_enable_sara.pin, GPIO_OUTPUT_ACTIVE);
	if (ret < 0) {
  		printk("Failed to configure SARA device binding.\n");
        return -1;
	}

	ret = gpio_pin_configure(change_voltage_sara.port, change_voltage_sara.pin, GPIO_OUTPUT_ACTIVE);
	if (ret < 0) {
  		printk("Failed to configure SARA device binding.\n");
        return -1;
	}
	ret = gpio_pin_set(change_voltage_sara.port, change_voltage_sara.pin, false);
	if (ret < 0) {
  		printk("Failed to configure SARA device binding.\n");
        return -1;
	}

    k_sleep(K_MSEC(500));
	ret = gpio_pin_configure(change_voltage_sara.port, change_voltage_sara.pin, GPIO_INPUT);
	if (ret < 0) {
  		printk("Failed to configure SARA device binding.\n");
        return -1;
	}

	k_sleep(K_MSEC(1000));



	// verifie configruration device
	printk("Name : %s\n", name);

	if(!test_device(uart_modem_sara))    return -1;
	if(!test_device(uart_debug))         return -1;
    
    
    console_getline_init();

	while (1) {
        printk("-----------------------------------------------------------------------\n");
        printk("Enter AT command : \n");

        printk("command : ");
		poll_data = console_getline();


        bool findCMD = false;
        for(int i=0; i<sizeof(at_cmd_map); i++){
            if(strcmp(poll_data, at_cmd_map[i]) == 0) findCMD=1;
        }


        if(findCMD){

            strcat(poll_data, end);

            if(test_poll_out(poll_data))    printk("Commande envoyée.\n");
            if(test_poll_in())				printk("\nFin de la réponse.\n");
            
        }
        else{
            printk("Mauvaise commande ou commande non reconnu\n");
        }
	}
    return 1;
}


int test_poll_in(void)
{
    uint8_t recv_char = 'N';
	uint8_t recv_char2 = 'N';

	//printk("Début réception : \n");
	/* Verify uart_poll_in() */
	while ((recv_char != 'K') && (recv_char2 != 'O')) {
        recv_char2 = recv_char;
		while (uart_poll_in(uart_modem_sara, &recv_char) < 0) {
			/* Allow other thread/workqueue to work. */
			k_yield();
		}
        uart_poll_out(uart_debug, recv_char);
	}
    //printk("\nFin réception.\n");
	return 1;
}


int test_poll_out(uint8_t *poll_data)
{
	int i;

	/* Verify uart_poll_out() */
	for (i = 0; i < strlen(poll_data); i++) {
		uart_poll_out(uart_modem_sara, poll_data[i]);
	}
	return 1;
}




// vérifie si le noeud récupéré n'est pas NULL et si il est prêt a être utilisé
int test_device(const struct device *uart_dev)
{

    if (!uart_dev) {
        printk("Cannot get UART device 1\n");
        return 0;
    }

    if(!device_is_ready(uart_dev)){
        printk("Device not ready\n");
        return 0;
    }
	return 1;
}
```
